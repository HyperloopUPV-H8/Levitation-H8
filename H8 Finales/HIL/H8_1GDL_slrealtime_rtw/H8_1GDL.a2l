/******************************************************************************
* ASAP2 file: H8_1GDL.a2l
* Academic License - for use in teaching, academic research, and meeting
* course requirements at degree granting institutions only. Not for
* government, commercial, or other organizational use.
* Code generation for model "H8_1GDL".
* Model version : 1.67
* Simulink Coder version : 10.6 R2022b
* C source code generated on : Tue Apr 04 14:32:57 2023
* Target selection: slrealtime.tlc
* Embedded hardware selection: Intel->x86-64 (Linux 64)
* Code generation objectives: Unspecified
* Validation result: Not run
* (add additional file header information here)
******************************************************************************/ ASAP2_VERSION 1 71
/* Version 1.71 */
/begin PROJECT ProjectName "Project Comment Goes Here"
/begin HEADER "Header Comments go here" /end HEADER
/begin MODULE ModuleName "Module Comment Goes Here"
/begin IF_DATA XCP
 /begin PROTOCOL_LAYER 0x0100 0x03E8 0x00C8 0x0000 0x0000 0x0000 0x0000 0x0000 0xFC 0x0578 BYTE_ORDER_MSB_LAST ADDRESS_GRANULARITY_BYTE OPTIONAL_CMD ALLOC_ODT_ENTRY OPTIONAL_CMD ALLOC_ODT OPTIONAL_CMD ALLOC_DAQ OPTIONAL_CMD FREE_DAQ OPTIONAL_CMD GET_DAQ_CLOCK OPTIONAL_CMD GET_DAQ_RESOLUTION_INFO OPTIONAL_CMD GET_DAQ_PROCESSOR_INFO OPTIONAL_CMD START_STOP_SYNCH OPTIONAL_CMD START_STOP_DAQ_LIST OPTIONAL_CMD SET_DAQ_LIST_MODE OPTIONAL_CMD WRITE_DAQ OPTIONAL_CMD SET_DAQ_PTR OPTIONAL_CMD GET_CAL_PAGE OPTIONAL_CMD SET_CAL_PAGE OPTIONAL_CMD COPY_CAL_PAGE OPTIONAL_CMD SHORT_DOWNLOAD OPTIONAL_CMD DOWNLOAD_MAX OPTIONAL_CMD DOWNLOAD OPTIONAL_CMD SHORT_UPLOAD OPTIONAL_CMD UPLOAD OPTIONAL_CMD SET_MTA OPTIONAL_CMD GET_SEGMENT_INFO OPTIONAL_CMD GET_PAGE_INFO OPTIONAL_CMD SET_SEGMENT_MODE OPTIONAL_CMD GET_SEGMENT_MODE OPTIONAL_CMD GET_PAG_PROCESSOR_INFO OPTIONAL_CMD MODIFY_BITS /end PROTOCOL_LAYER
 /begin DAQ DYNAMIC 0x0000 0x0080 0x00 OPTIMISATION_TYPE_DEFAULT ADDRESS_EXTENSION_FREE IDENTIFICATION_FIELD_TYPE_RELATIVE_WORD_ALIGNED GRANULARITY_ODT_ENTRY_SIZE_DAQ_BYTE 0xFF OVERLOAD_INDICATION_PID PRESCALER_SUPPORTED /begin STIM GRANULARITY_ODT_ENTRY_SIZE_STIM_BYTE 0xFF /end STIM /begin TIMESTAMP_SUPPORTED 0x0001 SIZE_DWORD UNIT_1US TIMESTAMP_FIXED /end TIMESTAMP_SUPPORTED /begin EVENT "250 us" "250 us" 0x0000 DAQ 0xFF 0x19 0x04 0x00 /end EVENT /begin EVENT "500 us" "500 us" 0x0001 DAQ 0xFF 0x05 0x05 0x00 /end EVENT /begin EVENT "1 ms" "1 ms" 0x0002 DAQ 0xFF 0x01 0x06 0x00 /end EVENT /end DAQ
 /begin XCP_ON_UDP_IP 0x0100 0x15B3 ADDRESS "192.168.7.5" /end XCP_ON_UDP_IP
/end IF_DATA
/begin MOD_PAR "MOD PAR Comment Goes Here" /end MOD_PAR
/begin MOD_COMMON "Mod Common Comment Here" BYTE_ORDER MSB_LAST ALIGNMENT_BYTE 1 ALIGNMENT_WORD 2 ALIGNMENT_LONG 4 ALIGNMENT_FLOAT32_IEEE 4 ALIGNMENT_FLOAT64_IEEE 8 ALIGNMENT_INT64 8 /end MOD_COMMON
/begin CHARACTERISTIC H8_1GDL_P.Constant_Value "" VALUE 0x00211790 Record_FLOAT64_IEEE 0 H8_1GDL_CM_double -1.7E+308 1.7E+308 /end CHARACTERISTIC
/begin CHARACTERISTIC H8_1GDL_P.Delay1_InitialCondition "" VALUE 0x002117C8 Record_FLOAT64_IEEE 0 H8_1GDL_CM_double -1.7E+308 1.7E+308 /end CHARACTERISTIC
/begin CHARACTERISTIC H8_1GDL_P.Delay1_InitialCondition_l "" VALUE 0x00211828 Record_FLOAT64_IEEE 0 H8_1GDL_CM_double -1.7E+308 1.7E+308 /end CHARACTERISTIC
/begin CHARACTERISTIC H8_1GDL_P.Delay2_InitialCondition "" VALUE 0x002117D0 Record_FLOAT64_IEEE 0 H8_1GDL_CM_double -1.7E+308 1.7E+308 /end CHARACTERISTIC
/begin CHARACTERISTIC H8_1GDL_P.Delay3_InitialCondition "" VALUE 0x002117D8 Record_FLOAT64_IEEE 0 H8_1GDL_CM_double -1.7E+308 1.7E+308 /end CHARACTERISTIC
/begin CHARACTERISTIC H8_1GDL_P.Delay_InitialCondition "" VALUE 0x002117C0 Record_FLOAT64_IEEE 0 H8_1GDL_CM_double -1.7E+308 1.7E+308 /end CHARACTERISTIC
/begin CHARACTERISTIC H8_1GDL_P.Delay_InitialCondition_j "" VALUE 0x00211820 Record_FLOAT64_IEEE 0 H8_1GDL_CM_double -1.7E+308 1.7E+308 /end CHARACTERISTIC
/begin CHARACTERISTIC H8_1GDL_P.Discr_Ampl_Max "" VALUE 0x002115E0 Record_FLOAT64_IEEE 0 H8_1GDL_CM_double -1.7E+308 1.7E+308 /end CHARACTERISTIC
/begin CHARACTERISTIC H8_1GDL_P.Discr_Ampl_Min "" VALUE 0x002115E8 Record_FLOAT64_IEEE 0 H8_1GDL_CM_double -1.7E+308 1.7E+308 /end CHARACTERISTIC
/begin CHARACTERISTIC H8_1GDL_P.Discr_Ampl_N "" VALUE 0x00211600 Record_FLOAT64_IEEE 0 H8_1GDL_CM_double -1.7E+308 1.7E+308 /end CHARACTERISTIC
/begin CHARACTERISTIC H8_1GDL_P.FilterDenConstant_Value "" VALUE 0x00211618 Record_FLOAT64_IEEE 0 H8_1GDL_CM_double -1.7E+308 1.7E+308 /end CHARACTERISTIC
/begin CHARACTERISTIC H8_1GDL_P.FilterDenConstant_Value_n "" VALUE 0x00211620 Record_FLOAT64_IEEE 0 H8_1GDL_CM_double -1.7E+308 1.7E+308 /end CHARACTERISTIC
/begin CHARACTERISTIC H8_1GDL_P.FilterDifferentiatorTF_NumCoe_d "" VAL_BLK 0x002117F8 Record_FLOAT64_IEEE 0 H8_1GDL_CM_double -1.7E+308 1.7E+308 MATRIX_DIM 2 1 /end CHARACTERISTIC
/begin CHARACTERISTIC H8_1GDL_P.FilterDifferentiatorTF_NumCoef "" VAL_BLK 0x002116F8 Record_FLOAT64_IEEE 0 H8_1GDL_CM_double -1.7E+308 1.7E+308 MATRIX_DIM 2 1 /end CHARACTERISTIC
/begin CHARACTERISTIC H8_1GDL_P.Integrator1_IC "" VALUE 0x00211648 Record_FLOAT64_IEEE 0 H8_1GDL_CM_double -1.7E+308 1.7E+308 /end CHARACTERISTIC
/begin CHARACTERISTIC H8_1GDL_P.Integrator4_IC "" VALUE 0x002116E8 Record_FLOAT64_IEEE 0 H8_1GDL_CM_double -1.7E+308 1.7E+308 /end CHARACTERISTIC
/begin CHARACTERISTIC H8_1GDL_P.Integrator_IC "" VALUE 0x00211628 Record_FLOAT64_IEEE 0 H8_1GDL_CM_double -1.7E+308 1.7E+308 /end CHARACTERISTIC
/begin CHARACTERISTIC H8_1GDL_P.Integrator_gainval "" VALUE 0x00211708 Record_FLOAT64_IEEE 0 H8_1GDL_CM_double -1.7E+308 1.7E+308 /end CHARACTERISTIC
/begin CHARACTERISTIC H8_1GDL_P.Integrator_gainval_d "" VALUE 0x00211808 Record_FLOAT64_IEEE 0 H8_1GDL_CM_double -1.7E+308 1.7E+308 /end CHARACTERISTIC
/begin CHARACTERISTIC H8_1GDL_P.MovingAverageFilter_M "" VALUE 0x002115D8 Record_FLOAT64_IEEE 0 H8_1GDL_CM_double -1.7E+308 1.7E+308 /end CHARACTERISTIC
/begin CHARACTERISTIC H8_1GDL_P.PIDController3_D "" VALUE 0x002115A8 Record_FLOAT64_IEEE 0 H8_1GDL_CM_double -1.7E+308 1.7E+308 /end CHARACTERISTIC
/begin CHARACTERISTIC H8_1GDL_P.PIDController3_I "" VALUE 0x002115B8 Record_FLOAT64_IEEE 0 H8_1GDL_CM_double -1.7E+308 1.7E+308 /end CHARACTERISTIC
/begin CHARACTERISTIC H8_1GDL_P.PIDController3_InitialCondition "" VALUE 0x002115C8 Record_FLOAT64_IEEE 0 H8_1GDL_CM_double -1.7E+308 1.7E+308 /end CHARACTERISTIC
/begin CHARACTERISTIC H8_1GDL_P.PIDController3_N "" VALUE 0x002115F8 Record_FLOAT64_IEEE 0 H8_1GDL_CM_double -1.7E+308 1.7E+308 /end CHARACTERISTIC
/begin CHARACTERISTIC H8_1GDL_P.PIDController3_P "" VALUE 0x00211610 Record_FLOAT64_IEEE 0 H8_1GDL_CM_double -1.7E+308 1.7E+308 /end CHARACTERISTIC
/begin CHARACTERISTIC H8_1GDL_P.PIDController4_D "" VALUE 0x002115A0 Record_FLOAT64_IEEE 0 H8_1GDL_CM_double -1.7E+308 1.7E+308 /end CHARACTERISTIC
/begin CHARACTERISTIC H8_1GDL_P.PIDController4_I "" VALUE 0x002115B0 Record_FLOAT64_IEEE 0 H8_1GDL_CM_double -1.7E+308 1.7E+308 /end CHARACTERISTIC
/begin CHARACTERISTIC H8_1GDL_P.PIDController4_InitialConditi_d "" VALUE 0x002115D0 Record_FLOAT64_IEEE 0 H8_1GDL_CM_double -1.7E+308 1.7E+308 /end CHARACTERISTIC
/begin CHARACTERISTIC H8_1GDL_P.PIDController4_InitialCondition "" VALUE 0x002115C0 Record_FLOAT64_IEEE 0 H8_1GDL_CM_double -1.7E+308 1.7E+308 /end CHARACTERISTIC
/begin CHARACTERISTIC H8_1GDL_P.PIDController4_N "" VALUE 0x002115F0 Record_FLOAT64_IEEE 0 H8_1GDL_CM_double -1.7E+308 1.7E+308 /end CHARACTERISTIC
/begin CHARACTERISTIC H8_1GDL_P.PIDController4_P "" VALUE 0x00211608 Record_FLOAT64_IEEE 0 H8_1GDL_CM_double -1.7E+308 1.7E+308 /end CHARACTERISTIC
/begin CHARACTERISTIC H8_1GDL_P.Saturation1_LowerSat "" VALUE 0x00211718 Record_FLOAT64_IEEE 0 H8_1GDL_CM_double -1.7E+308 1.7E+308 /end CHARACTERISTIC
/begin CHARACTERISTIC H8_1GDL_P.Saturation1_UpperSat "" VALUE 0x00211710 Record_FLOAT64_IEEE 0 H8_1GDL_CM_double -1.7E+308 1.7E+308 /end CHARACTERISTIC
/begin CHARACTERISTIC H8_1GDL_P.Saturation6_LowerSat "" VALUE 0x00211818 Record_FLOAT64_IEEE 0 H8_1GDL_CM_double -1.7E+308 1.7E+308 /end CHARACTERISTIC
/begin CHARACTERISTIC H8_1GDL_P.Saturation6_UpperSat "" VALUE 0x00211810 Record_FLOAT64_IEEE 0 H8_1GDL_CM_double -1.7E+308 1.7E+308 /end CHARACTERISTIC
/begin CHARACTERISTIC H8_1GDL_P.Saturation8_LowerSat "" VALUE 0x00211658 Record_FLOAT64_IEEE 0 H8_1GDL_CM_double -1.7E+308 1.7E+308 /end CHARACTERISTIC
/begin CHARACTERISTIC H8_1GDL_P.Saturation8_UpperSat "" VALUE 0x00211650 Record_FLOAT64_IEEE 0 H8_1GDL_CM_double -1.7E+308 1.7E+308 /end CHARACTERISTIC
/begin CHARACTERISTIC H8_1GDL_P.Seccion_Value "" VALUE 0x00211798 Record_FLOAT64_IEEE 0 H8_1GDL_CM_double -1.7E+308 1.7E+308 /end CHARACTERISTIC
/begin CHARACTERISTIC H8_1GDL_P.Tamb_Value "" VALUE 0x00211630 Record_FLOAT64_IEEE 0 H8_1GDL_CM_double -1.7E+308 1.7E+308 /end CHARACTERISTIC
/begin CHARACTERISTIC H8_1GDL_P.Temperature_Value "" VALUE 0x002117E0 Record_FLOAT64_IEEE 0 H8_1GDL_CM_double -1.7E+308 1.7E+308 /end CHARACTERISTIC
/begin CHARACTERISTIC H8_1GDL_P.TmpRTBAtAdd5Inport1_InitialCond "" VALUE 0x002116D0 Record_FLOAT64_IEEE 0 H8_1GDL_CM_double -1.7E+308 1.7E+308 /end CHARACTERISTIC
/begin CHARACTERISTIC H8_1GDL_P.TmpRTBAtSum1Outport1_InitialCon "" VALUE 0x002117E8 Record_FLOAT64_IEEE 0 H8_1GDL_CM_double -1.7E+308 1.7E+308 /end CHARACTERISTIC
/begin CHARACTERISTIC H8_1GDL_P.TmpRTBAtZeroOrderHoldInport1_In "" VALUE 0x002116E0 Record_FLOAT64_IEEE 0 H8_1GDL_CM_double -1.7E+308 1.7E+308 /end CHARACTERISTIC
/begin CHARACTERISTIC H8_1GDL_P.Tomm_Gain "" VALUE 0x00211640 Record_FLOAT64_IEEE 0 H8_1GDL_CM_double -1.7E+308 1.7E+308 /end CHARACTERISTIC
/begin CHARACTERISTIC H8_1GDL_P.Tref_Value "" VALUE 0x002117A8 Record_FLOAT64_IEEE 0 H8_1GDL_CM_double -1.7E+308 1.7E+308 /end CHARACTERISTIC
/begin CHARACTERISTIC H8_1GDL_P.Tsamp_WtEt "" VALUE 0x002116F0 Record_FLOAT64_IEEE 0 H8_1GDL_CM_double -1.7E+308 1.7E+308 /end CHARACTERISTIC
/begin CHARACTERISTIC H8_1GDL_P.Tsamp_WtEt_n "" VALUE 0x002117F0 Record_FLOAT64_IEEE 0 H8_1GDL_CM_double -1.7E+308 1.7E+308 /end CHARACTERISTIC
/begin CHARACTERISTIC H8_1GDL_P.coeficiente_transferencia_Value "" VALUE 0x002117B8 Record_FLOAT64_IEEE 0 H8_1GDL_CM_double -1.7E+308 1.7E+308 /end CHARACTERISTIC
/begin CHARACTERISTIC H8_1GDL_P.densidad_Value "" VALUE 0x002117B0 Record_FLOAT64_IEEE 0 H8_1GDL_CM_double -1.7E+308 1.7E+308 /end CHARACTERISTIC
/begin CHARACTERISTIC H8_1GDL_P.dist_sensor1_Value "" VALUE 0x00211638 Record_FLOAT64_IEEE 0 H8_1GDL_CM_double -1.7E+308 1.7E+308 /end CHARACTERISTIC
/begin CHARACTERISTIC H8_1GDL_P.dist_sensor_Value "" VALUE 0x00211830 Record_FLOAT64_IEEE 0 H8_1GDL_CM_double -1.7E+308 1.7E+308 /end CHARACTERISTIC
/begin CHARACTERISTIC H8_1GDL_P.g "" VALUE 0x00211578 Record_FLOAT64_IEEE 0 H8_1GDL_CM_double -1.7E+308 1.7E+308 /end CHARACTERISTIC
/begin CHARACTERISTIC H8_1GDL_P.hems.Airgap "" VAL_BLK 0x00205020 Record_FLOAT64_IEEE 0 H8_1GDL_CM_double -1.7E+308 1.7E+308 MATRIX_DIM 14 1 /end CHARACTERISTIC
/begin CHARACTERISTIC H8_1GDL_P.hems.Current "" VAL_BLK 0x00205090 Record_FLOAT64_IEEE 0 H8_1GDL_CM_double -1.7E+308 1.7E+308 MATRIX_DIM 111 1 /end CHARACTERISTIC
/begin CHARACTERISTIC H8_1GDL_P.hems.Flux "" VAL_BLK 0x00208498 Record_FLOAT64_IEEE 0 H8_1GDL_CM_double -1.7E+308 1.7E+308 MATRIX_DIM 111 14 /end CHARACTERISTIC
/begin CHARACTERISTIC H8_1GDL_P.hems.Force_Horizontal "" VAL_BLK 0x0020B528 Record_FLOAT64_IEEE 0 H8_1GDL_CM_double -1.7E+308 1.7E+308 MATRIX_DIM 111 14 /end CHARACTERISTIC
/begin CHARACTERISTIC H8_1GDL_P.hems.Force_Vertical "" VAL_BLK 0x00205408 Record_FLOAT64_IEEE 0 H8_1GDL_CM_double -1.7E+308 1.7E+308 MATRIX_DIM 111 14 /end CHARACTERISTIC
/begin CHARACTERISTIC H8_1GDL_P.hems.Inductance "" VAL_BLK 0x0020E5B8 Record_FLOAT64_IEEE 0 H8_1GDL_CM_double -1.7E+308 1.7E+308 MATRIX_DIM 109 14 /end CHARACTERISTIC
/begin CHARACTERISTIC H8_1GDL_P.hems.Resistance "" VALUE 0x00211570 Record_FLOAT64_IEEE 0 H8_1GDL_CM_double -1.7E+308 1.7E+308 /end CHARACTERISTIC
/begin CHARACTERISTIC H8_1GDL_P.hems.masa_bobina "" VALUE 0x00211568 Record_FLOAT64_IEEE 0 H8_1GDL_CM_double -1.7E+308 1.7E+308 /end CHARACTERISTIC
/begin CHARACTERISTIC H8_1GDL_P.lev_nom "" VALUE 0x00211580 Record_FLOAT64_IEEE 0 H8_1GDL_CM_double -1.7E+308 1.7E+308 /end CHARACTERISTIC
/begin CHARACTERISTIC H8_1GDL_P.m "" VALUE 0x00211588 Record_FLOAT64_IEEE 0 H8_1GDL_CM_double -1.7E+308 1.7E+308 /end CHARACTERISTIC
/begin CHARACTERISTIC H8_1GDL_P.resistividad_Value "" VALUE 0x002117A0 Record_FLOAT64_IEEE 0 H8_1GDL_CM_double -1.7E+308 1.7E+308 /end CHARACTERISTIC
/begin CHARACTERISTIC H8_1GDL_P.senal_discretizada_InitialCondi "" VALUE 0x002116D8 Record_FLOAT64_IEEE 0 H8_1GDL_CM_double -1.7E+308 1.7E+308 /end CHARACTERISTIC
/begin CHARACTERISTIC H8_1GDL_P.suelo "" VALUE 0x00211590 Record_FLOAT64_IEEE 0 H8_1GDL_CM_double -1.7E+308 1.7E+308 /end CHARACTERISTIC
/begin CHARACTERISTIC H8_1GDL_P.techo "" VALUE 0x00211598 Record_FLOAT64_IEEE 0 H8_1GDL_CM_double -1.7E+308 1.7E+308 /end CHARACTERISTIC
/begin CHARACTERISTIC H8_1GDL_P.uDLookupTable1_maxIndex "" VAL_BLK 0x00211840 Record_ULONG 0 H8_1GDL_CM_uint32 0 4294967295 MATRIX_DIM 2 /end CHARACTERISTIC
/begin CHARACTERISTIC H8_1GDL_P.uDLookupTable_maxIndex "" VAL_BLK 0x00211838 Record_ULONG 0 H8_1GDL_CM_uint32 0 4294967295 MATRIX_DIM 2 /end CHARACTERISTIC
/begin CHARACTERISTIC H8_1GDL_P.uDLookupTable_maxIndex_d "" VAL_BLK 0x00211848 Record_ULONG 0 H8_1GDL_CM_uint32 0 4294967295 MATRIX_DIM 2 /end CHARACTERISTIC
/begin MEASUREMENT H8_1GDL_B.Add "" FLOAT64_IEEE H8_1GDL_CM_double 0 0 -1.7E+308 1.7E+308 ECU_ADDRESS 0x00211E58 /end MEASUREMENT
/begin MEASUREMENT H8_1GDL_B.Add5 "" FLOAT64_IEEE H8_1GDL_CM_double 0 0 -1.7E+308 1.7E+308 ECU_ADDRESS 0x00211D40 /end MEASUREMENT
/begin MEASUREMENT H8_1GDL_B.Delay "" FLOAT64_IEEE H8_1GDL_CM_double 0 0 -1.7E+308 1.7E+308 ECU_ADDRESS 0x00211E38
 /begin IF_DATA XCP
  /begin DAQ_EVENT VARIABLE /begin DEFAULT_EVENT_LIST EVENT 0x0001 /end DEFAULT_EVENT_LIST /end DAQ_EVENT
 /end IF_DATA
/end MEASUREMENT
/begin MEASUREMENT H8_1GDL_B.Delay1 "" FLOAT64_IEEE H8_1GDL_CM_double 0 0 -1.7E+308 1.7E+308 ECU_ADDRESS 0x00211E40
 /begin IF_DATA XCP
  /begin DAQ_EVENT VARIABLE /begin DEFAULT_EVENT_LIST EVENT 0x0001 /end DEFAULT_EVENT_LIST /end DAQ_EVENT
 /end IF_DATA
/end MEASUREMENT
/begin MEASUREMENT H8_1GDL_B.Delay1_n "" FLOAT64_IEEE H8_1GDL_CM_double 0 0 -1.7E+308 1.7E+308 ECU_ADDRESS 0x00211F30
 /begin IF_DATA XCP
  /begin DAQ_EVENT VARIABLE /begin DEFAULT_EVENT_LIST EVENT 0x0003 /end DEFAULT_EVENT_LIST /end DAQ_EVENT
 /end IF_DATA
/end MEASUREMENT
/begin MEASUREMENT H8_1GDL_B.Delay2 "" FLOAT64_IEEE H8_1GDL_CM_double 0 0 -1.7E+308 1.7E+308 ECU_ADDRESS 0x00211E60
 /begin IF_DATA XCP
  /begin DAQ_EVENT VARIABLE /begin DEFAULT_EVENT_LIST EVENT 0x0001 /end DEFAULT_EVENT_LIST /end DAQ_EVENT
 /end IF_DATA
/end MEASUREMENT
/begin MEASUREMENT H8_1GDL_B.Delay3 "" FLOAT64_IEEE H8_1GDL_CM_double 0 0 -1.7E+308 1.7E+308 ECU_ADDRESS 0x00211E68
 /begin IF_DATA XCP
  /begin DAQ_EVENT VARIABLE /begin DEFAULT_EVENT_LIST EVENT 0x0001 /end DEFAULT_EVENT_LIST /end DAQ_EVENT
 /end IF_DATA
/end MEASUREMENT
/begin MEASUREMENT H8_1GDL_B.Delay_j "" FLOAT64_IEEE H8_1GDL_CM_double 0 0 -1.7E+308 1.7E+308 ECU_ADDRESS 0x00211F20
 /begin IF_DATA XCP
  /begin DAQ_EVENT VARIABLE /begin DEFAULT_EVENT_LIST EVENT 0x0003 /end DEFAULT_EVENT_LIST /end DAQ_EVENT
 /end IF_DATA
/end MEASUREMENT
/begin MEASUREMENT H8_1GDL_B.DenCoefOut "" FLOAT64_IEEE H8_1GDL_CM_double 0 0 -1.7E+308 1.7E+308 ECU_ADDRESS 0x00211DB0
 /begin IF_DATA XCP
  /begin DAQ_EVENT VARIABLE /begin DEFAULT_EVENT_LIST EVENT 0x0001 /end DEFAULT_EVENT_LIST /end DAQ_EVENT
 /end IF_DATA
/end MEASUREMENT
/begin MEASUREMENT H8_1GDL_B.DenCoefOut_a "" FLOAT64_IEEE H8_1GDL_CM_double 0 0 -1.7E+308 1.7E+308 ECU_ADDRESS 0x00211ED8
 /begin IF_DATA XCP
  /begin DAQ_EVENT VARIABLE /begin DEFAULT_EVENT_LIST EVENT 0x0002 /end DEFAULT_EVENT_LIST /end DAQ_EVENT
 /end IF_DATA
/end MEASUREMENT
/begin MEASUREMENT H8_1GDL_B.DerivativeGain "" FLOAT64_IEEE H8_1GDL_CM_double 0 0 -1.7E+308 1.7E+308 ECU_ADDRESS 0x00211D60
 /begin IF_DATA XCP
  /begin DAQ_EVENT VARIABLE /begin DEFAULT_EVENT_LIST EVENT 0x0001 /end DEFAULT_EVENT_LIST /end DAQ_EVENT
 /end IF_DATA
/end MEASUREMENT
/begin MEASUREMENT H8_1GDL_B.DerivativeGain_a "" FLOAT64_IEEE H8_1GDL_CM_double 0 0 -1.7E+308 1.7E+308 ECU_ADDRESS 0x00211E88
 /begin IF_DATA XCP
  /begin DAQ_EVENT VARIABLE /begin DEFAULT_EVENT_LIST EVENT 0x0002 /end DEFAULT_EVENT_LIST /end DAQ_EVENT
 /end IF_DATA
/end MEASUREMENT
/begin MEASUREMENT H8_1GDL_B.Divide "" FLOAT64_IEEE H8_1GDL_CM_double 0 0 -1.7E+308 1.7E+308 ECU_ADDRESS 0x00211D90
 /begin IF_DATA XCP
  /begin DAQ_EVENT VARIABLE /begin DEFAULT_EVENT_LIST EVENT 0x0001 /end DEFAULT_EVENT_LIST /end DAQ_EVENT
 /end IF_DATA
/end MEASUREMENT
/begin MEASUREMENT H8_1GDL_B.Divide1 "" FLOAT64_IEEE H8_1GDL_CM_double 0 0 -1.7E+308 1.7E+308 ECU_ADDRESS 0x00211E30 /end MEASUREMENT
/begin MEASUREMENT H8_1GDL_B.Divide2 "" FLOAT64_IEEE H8_1GDL_CM_double 0 0 -1.7E+308 1.7E+308 ECU_ADDRESS 0x00211D50 /end MEASUREMENT
/begin MEASUREMENT H8_1GDL_B.Divide2_h "" FLOAT64_IEEE H8_1GDL_CM_double 0 0 -1.7E+308 1.7E+308 ECU_ADDRESS 0x00211E70
 /begin IF_DATA XCP
  /begin DAQ_EVENT VARIABLE /begin DEFAULT_EVENT_LIST EVENT 0x0001 /end DEFAULT_EVENT_LIST /end DAQ_EVENT
 /end IF_DATA
/end MEASUREMENT
/begin MEASUREMENT H8_1GDL_B.Divide_f "" FLOAT64_IEEE H8_1GDL_CM_double 0 0 -1.7E+308 1.7E+308 ECU_ADDRESS 0x00211E78 /end MEASUREMENT
/begin MEASUREMENT H8_1GDL_B.Divide_g "" FLOAT64_IEEE H8_1GDL_CM_double 0 0 -1.7E+308 1.7E+308 ECU_ADDRESS 0x00211EB8
 /begin IF_DATA XCP
  /begin DAQ_EVENT VARIABLE /begin DEFAULT_EVENT_LIST EVENT 0x0002 /end DEFAULT_EVENT_LIST /end DAQ_EVENT
 /end IF_DATA
/end MEASUREMENT
/begin MEASUREMENT H8_1GDL_B.Divide_p "" FLOAT64_IEEE H8_1GDL_CM_double 0 0 -1.7E+308 1.7E+308 ECU_ADDRESS 0x00211DF0 /end MEASUREMENT
/begin MEASUREMENT H8_1GDL_B.F "" FLOAT64_IEEE H8_1GDL_CM_double 0 0 -1.7E+308 1.7E+308 ECU_ADDRESS 0x00211D30 /end MEASUREMENT
/begin MEASUREMENT H8_1GDL_B.Fg "" FLOAT64_IEEE H8_1GDL_CM_double 0 0 -1.7E+308 1.7E+308 ECU_ADDRESS 0x00211D08
 /begin IF_DATA XCP
  /begin DAQ_EVENT VARIABLE /begin DEFAULT_EVENT_LIST EVENT 0x0001 /end DEFAULT_EVENT_LIST /end DAQ_EVENT
 /end IF_DATA
/end MEASUREMENT
/begin MEASUREMENT H8_1GDL_B.FilterCoefficient "" FLOAT64_IEEE H8_1GDL_CM_double 0 0 -1.7E+308 1.7E+308 ECU_ADDRESS 0x00211DC8
 /begin IF_DATA XCP
  /begin DAQ_EVENT VARIABLE /begin DEFAULT_EVENT_LIST EVENT 0x0001 /end DEFAULT_EVENT_LIST /end DAQ_EVENT
 /end IF_DATA
/end MEASUREMENT
/begin MEASUREMENT H8_1GDL_B.FilterCoefficient_a "" FLOAT64_IEEE H8_1GDL_CM_double 0 0 -1.7E+308 1.7E+308 ECU_ADDRESS 0x00211EF0
 /begin IF_DATA XCP
  /begin DAQ_EVENT VARIABLE /begin DEFAULT_EVENT_LIST EVENT 0x0002 /end DEFAULT_EVENT_LIST /end DAQ_EVENT
 /end IF_DATA
/end MEASUREMENT
/begin MEASUREMENT H8_1GDL_B.FilterDifferentiatorTF "" FLOAT64_IEEE H8_1GDL_CM_double 0 0 -1.7E+308 1.7E+308 ECU_ADDRESS 0x00211DA8
 /begin IF_DATA XCP
  /begin DAQ_EVENT VARIABLE /begin DEFAULT_EVENT_LIST EVENT 0x0001 /end DEFAULT_EVENT_LIST /end DAQ_EVENT
 /end IF_DATA
/end MEASUREMENT
/begin MEASUREMENT H8_1GDL_B.FilterDifferentiatorTF_a "" FLOAT64_IEEE H8_1GDL_CM_double 0 0 -1.7E+308 1.7E+308 ECU_ADDRESS 0x00211ED0
 /begin IF_DATA XCP
  /begin DAQ_EVENT VARIABLE /begin DEFAULT_EVENT_LIST EVENT 0x0002 /end DEFAULT_EVENT_LIST /end DAQ_EVENT
 /end IF_DATA
/end MEASUREMENT
/begin MEASUREMENT H8_1GDL_B.Fl "" FLOAT64_IEEE H8_1GDL_CM_double 0 0 -1.7E+308 1.7E+308 ECU_ADDRESS 0x00211D28 /end MEASUREMENT
/begin MEASUREMENT H8_1GDL_B.Fl_m "" FLOAT64_IEEE H8_1GDL_CM_double 0 0 -1.7E+308 1.7E+308 ECU_ADDRESS 0x00211DE8 /end MEASUREMENT
/begin MEASUREMENT H8_1GDL_B.Gain "" FLOAT64_IEEE H8_1GDL_CM_double 0 0 -1.7E+308 1.7E+308 ECU_ADDRESS 0x00211F40
 /begin IF_DATA XCP
  /begin DAQ_EVENT VARIABLE /begin DEFAULT_EVENT_LIST EVENT 0x0003 /end DEFAULT_EVENT_LIST /end DAQ_EVENT
 /end IF_DATA
/end MEASUREMENT
/begin MEASUREMENT H8_1GDL_B.I "" FLOAT64_IEEE H8_1GDL_CM_double 0 0 -1.7E+308 1.7E+308 ECU_ADDRESS 0x00211D20 /end MEASUREMENT
/begin MEASUREMENT H8_1GDL_B.IntegralGain "" FLOAT64_IEEE H8_1GDL_CM_double 0 0 -1.7E+308 1.7E+308 ECU_ADDRESS 0x00211DB8
 /begin IF_DATA XCP
  /begin DAQ_EVENT VARIABLE /begin DEFAULT_EVENT_LIST EVENT 0x0001 /end DEFAULT_EVENT_LIST /end DAQ_EVENT
 /end IF_DATA
/end MEASUREMENT
/begin MEASUREMENT H8_1GDL_B.IntegralGain_e "" FLOAT64_IEEE H8_1GDL_CM_double 0 0 -1.7E+308 1.7E+308 ECU_ADDRESS 0x00211EE0
 /begin IF_DATA XCP
  /begin DAQ_EVENT VARIABLE /begin DEFAULT_EVENT_LIST EVENT 0x0002 /end DEFAULT_EVENT_LIST /end DAQ_EVENT
 /end IF_DATA
/end MEASUREMENT
/begin MEASUREMENT H8_1GDL_B.Integrator "" FLOAT64_IEEE H8_1GDL_CM_double 0 0 -1.7E+308 1.7E+308 ECU_ADDRESS 0x00211CE0 /end MEASUREMENT
/begin MEASUREMENT H8_1GDL_B.Integrator_c "" FLOAT64_IEEE H8_1GDL_CM_double 0 0 -1.7E+308 1.7E+308 ECU_ADDRESS 0x00211DC0
 /begin IF_DATA XCP
  /begin DAQ_EVENT VARIABLE /begin DEFAULT_EVENT_LIST EVENT 0x0001 /end DEFAULT_EVENT_LIST /end DAQ_EVENT
 /end IF_DATA
/end MEASUREMENT
/begin MEASUREMENT H8_1GDL_B.Integrator_n "" FLOAT64_IEEE H8_1GDL_CM_double 0 0 -1.7E+308 1.7E+308 ECU_ADDRESS 0x00211EE8
 /begin IF_DATA XCP
  /begin DAQ_EVENT VARIABLE /begin DEFAULT_EVENT_LIST EVENT 0x0002 /end DEFAULT_EVENT_LIST /end DAQ_EVENT
 /end IF_DATA
/end MEASUREMENT
/begin MEASUREMENT H8_1GDL_B.L "" FLOAT64_IEEE H8_1GDL_CM_double 0 0 -1.7E+308 1.7E+308 ECU_ADDRESS 0x00211E48
 /begin IF_DATA XCP
  /begin DAQ_EVENT VARIABLE /begin DEFAULT_EVENT_LIST EVENT 0x0001 /end DEFAULT_EVENT_LIST /end DAQ_EVENT
 /end IF_DATA
/end MEASUREMENT
/begin MEASUREMENT H8_1GDL_B.MathFunction "" FLOAT64_IEEE H8_1GDL_CM_double 0 0 -1.7E+308 1.7E+308 ECU_ADDRESS 0x00211DF8 /end MEASUREMENT
/begin MEASUREMENT H8_1GDL_B.Passthroughfortuning "" FLOAT64_IEEE H8_1GDL_CM_double 0 0 -1.7E+308 1.7E+308 ECU_ADDRESS 0x00211D68
 /begin IF_DATA XCP
  /begin DAQ_EVENT VARIABLE /begin DEFAULT_EVENT_LIST EVENT 0x0001 /end DEFAULT_EVENT_LIST /end DAQ_EVENT
 /end IF_DATA
/end MEASUREMENT
/begin MEASUREMENT H8_1GDL_B.Passthroughfortuning_f "" FLOAT64_IEEE H8_1GDL_CM_double 0 0 -1.7E+308 1.7E+308 ECU_ADDRESS 0x00211E90
 /begin IF_DATA XCP
  /begin DAQ_EVENT VARIABLE /begin DEFAULT_EVENT_LIST EVENT 0x0002 /end DEFAULT_EVENT_LIST /end DAQ_EVENT
 /end IF_DATA
/end MEASUREMENT
/begin MEASUREMENT H8_1GDL_B.Product "" FLOAT64_IEEE H8_1GDL_CM_double 0 0 -1.7E+308 1.7E+308 ECU_ADDRESS 0x00211E20 /end MEASUREMENT
/begin MEASUREMENT H8_1GDL_B.Product1 "" FLOAT64_IEEE H8_1GDL_CM_double 0 0 -1.7E+308 1.7E+308 ECU_ADDRESS 0x00211E18 /end MEASUREMENT
/begin MEASUREMENT H8_1GDL_B.Product2 "" FLOAT64_IEEE H8_1GDL_CM_double 0 0 -1.7E+308 1.7E+308 ECU_ADDRESS 0x00211E28
 /begin IF_DATA XCP
  /begin DAQ_EVENT VARIABLE /begin DEFAULT_EVENT_LIST EVENT 0x0001 /end DEFAULT_EVENT_LIST /end DAQ_EVENT
 /end IF_DATA
/end MEASUREMENT
/begin MEASUREMENT H8_1GDL_B.ProportionalGain "" FLOAT64_IEEE H8_1GDL_CM_double 0 0 -1.7E+308 1.7E+308 ECU_ADDRESS 0x00211DD0
 /begin IF_DATA XCP
  /begin DAQ_EVENT VARIABLE /begin DEFAULT_EVENT_LIST EVENT 0x0001 /end DEFAULT_EVENT_LIST /end DAQ_EVENT
 /end IF_DATA
/end MEASUREMENT
/begin MEASUREMENT H8_1GDL_B.ProportionalGain_g "" FLOAT64_IEEE H8_1GDL_CM_double 0 0 -1.7E+308 1.7E+308 ECU_ADDRESS 0x00211EF8
 /begin IF_DATA XCP
  /begin DAQ_EVENT VARIABLE /begin DEFAULT_EVENT_LIST EVENT 0x0002 /end DEFAULT_EVENT_LIST /end DAQ_EVENT
 /end IF_DATA
/end MEASUREMENT
/begin MEASUREMENT H8_1GDL_B.Reciprocal "" FLOAT64_IEEE H8_1GDL_CM_double 0 0 -1.7E+308 1.7E+308 ECU_ADDRESS 0x00211D80
 /begin IF_DATA XCP
  /begin DAQ_EVENT VARIABLE /begin DEFAULT_EVENT_LIST EVENT 0x0001 /end DEFAULT_EVENT_LIST /end DAQ_EVENT
 /end IF_DATA
/end MEASUREMENT
/begin MEASUREMENT H8_1GDL_B.Reciprocal_n "" FLOAT64_IEEE H8_1GDL_CM_double 0 0 -1.7E+308 1.7E+308 ECU_ADDRESS 0x00211EA8
 /begin IF_DATA XCP
  /begin DAQ_EVENT VARIABLE /begin DEFAULT_EVENT_LIST EVENT 0x0002 /end DEFAULT_EVENT_LIST /end DAQ_EVENT
 /end IF_DATA
/end MEASUREMENT
/begin MEASUREMENT H8_1GDL_B.Saturation6 "" FLOAT64_IEEE H8_1GDL_CM_double 0 0 -1.7E+308 1.7E+308 ECU_ADDRESS 0x00211F08
 /begin IF_DATA XCP
  /begin DAQ_EVENT VARIABLE /begin DEFAULT_EVENT_LIST EVENT 0x0002 /end DEFAULT_EVENT_LIST /end DAQ_EVENT
 /end IF_DATA
/end MEASUREMENT
/begin MEASUREMENT H8_1GDL_B.Sum "" FLOAT64_IEEE H8_1GDL_CM_double 0 0 -1.7E+308 1.7E+308 ECU_ADDRESS 0x00211CE8 /end MEASUREMENT
/begin MEASUREMENT H8_1GDL_B.Sum1 "" FLOAT64_IEEE H8_1GDL_CM_double 0 0 -1.7E+308 1.7E+308 ECU_ADDRESS 0x00211E00 /end MEASUREMENT
/begin MEASUREMENT H8_1GDL_B.Sum1_a "" FLOAT64_IEEE H8_1GDL_CM_double 0 0 -1.7E+308 1.7E+308 ECU_ADDRESS 0x00211F38
 /begin IF_DATA XCP
  /begin DAQ_EVENT VARIABLE /begin DEFAULT_EVENT_LIST EVENT 0x0003 /end DEFAULT_EVENT_LIST /end DAQ_EVENT
 /end IF_DATA
/end MEASUREMENT
/begin MEASUREMENT H8_1GDL_B.Sum1_e "" FLOAT64_IEEE H8_1GDL_CM_double 0 0 -1.7E+308 1.7E+308 ECU_ADDRESS 0x00211F50
 /begin IF_DATA XCP
  /begin DAQ_EVENT VARIABLE /begin DEFAULT_EVENT_LIST EVENT 0x0003 /end DEFAULT_EVENT_LIST /end DAQ_EVENT
 /end IF_DATA
/end MEASUREMENT
/begin MEASUREMENT H8_1GDL_B.Sum2 "" FLOAT64_IEEE H8_1GDL_CM_double 0 0 -1.7E+308 1.7E+308 ECU_ADDRESS 0x00211E10 /end MEASUREMENT
/begin MEASUREMENT H8_1GDL_B.Sum3 "" FLOAT64_IEEE H8_1GDL_CM_double 0 0 -1.7E+308 1.7E+308 ECU_ADDRESS 0x00211F48
 /begin IF_DATA XCP
  /begin DAQ_EVENT VARIABLE /begin DEFAULT_EVENT_LIST EVENT 0x0003 /end DEFAULT_EVENT_LIST /end DAQ_EVENT
 /end IF_DATA
/end MEASUREMENT
/begin MEASUREMENT H8_1GDL_B.SumDen "" FLOAT64_IEEE H8_1GDL_CM_double 0 0 -1.7E+308 1.7E+308 ECU_ADDRESS 0x00211D78
 /begin IF_DATA XCP
  /begin DAQ_EVENT VARIABLE /begin DEFAULT_EVENT_LIST EVENT 0x0001 /end DEFAULT_EVENT_LIST /end DAQ_EVENT
 /end IF_DATA
/end MEASUREMENT
/begin MEASUREMENT H8_1GDL_B.SumDen_k "" FLOAT64_IEEE H8_1GDL_CM_double 0 0 -1.7E+308 1.7E+308 ECU_ADDRESS 0x00211EA0
 /begin IF_DATA XCP
  /begin DAQ_EVENT VARIABLE /begin DEFAULT_EVENT_LIST EVENT 0x0002 /end DEFAULT_EVENT_LIST /end DAQ_EVENT
 /end IF_DATA
/end MEASUREMENT
/begin MEASUREMENT H8_1GDL_B.SumNum "" FLOAT64_IEEE H8_1GDL_CM_double 0 0 -1.7E+308 1.7E+308 ECU_ADDRESS 0x00211D88
 /begin IF_DATA XCP
  /begin DAQ_EVENT VARIABLE /begin DEFAULT_EVENT_LIST EVENT 0x0001 /end DEFAULT_EVENT_LIST /end DAQ_EVENT
 /end IF_DATA
/end MEASUREMENT
/begin MEASUREMENT H8_1GDL_B.SumNum_h "" FLOAT64_IEEE H8_1GDL_CM_double 0 0 -1.7E+308 1.7E+308 ECU_ADDRESS 0x00211EB0
 /begin IF_DATA XCP
  /begin DAQ_EVENT VARIABLE /begin DEFAULT_EVENT_LIST EVENT 0x0002 /end DEFAULT_EVENT_LIST /end DAQ_EVENT
 /end IF_DATA
/end MEASUREMENT
/begin MEASUREMENT H8_1GDL_B.Sum_e "" FLOAT64_IEEE H8_1GDL_CM_double 0 0 -1.7E+308 1.7E+308 ECU_ADDRESS 0x00211F00
 /begin IF_DATA XCP
  /begin DAQ_EVENT VARIABLE /begin DEFAULT_EVENT_LIST EVENT 0x0002 /end DEFAULT_EVENT_LIST /end DAQ_EVENT
 /end IF_DATA
/end MEASUREMENT
/begin MEASUREMENT H8_1GDL_B.Sum_f "" FLOAT64_IEEE H8_1GDL_CM_double 0 0 -1.7E+308 1.7E+308 ECU_ADDRESS 0x00211DD8
 /begin IF_DATA XCP
  /begin DAQ_EVENT VARIABLE /begin DEFAULT_EVENT_LIST EVENT 0x0001 /end DEFAULT_EVENT_LIST /end DAQ_EVENT
 /end IF_DATA
/end MEASUREMENT
/begin MEASUREMENT H8_1GDL_B.Sum_p "" FLOAT64_IEEE H8_1GDL_CM_double 0 0 -1.7E+308 1.7E+308 ECU_ADDRESS 0x00211F28
 /begin IF_DATA XCP
  /begin DAQ_EVENT VARIABLE /begin DEFAULT_EVENT_LIST EVENT 0x0003 /end DEFAULT_EVENT_LIST /end DAQ_EVENT
 /end IF_DATA
/end MEASUREMENT
/begin MEASUREMENT H8_1GDL_B.TmpRTBAtAdd5Inport1 "" FLOAT64_IEEE H8_1GDL_CM_double 0 0 -1.7E+308 1.7E+308 ECU_ADDRESS 0x00211D38
 /begin IF_DATA XCP
  /begin DAQ_EVENT VARIABLE /begin DEFAULT_EVENT_LIST EVENT 0x0001 /end DEFAULT_EVENT_LIST /end DAQ_EVENT
 /end IF_DATA
/end MEASUREMENT
/begin MEASUREMENT H8_1GDL_B.TmpRTBAtSum1Outport1 "" FLOAT64_IEEE H8_1GDL_CM_double 0 0 -1.7E+308 1.7E+308 ECU_ADDRESS 0x00211E80
 /begin IF_DATA XCP
  /begin DAQ_EVENT VARIABLE /begin DEFAULT_EVENT_LIST EVENT 0x0002 /end DEFAULT_EVENT_LIST /end DAQ_EVENT
 /end IF_DATA
/end MEASUREMENT
/begin MEASUREMENT H8_1GDL_B.TmpRTBAtZeroOrderHoldInport1 "" FLOAT64_IEEE H8_1GDL_CM_double 0 0 -1.7E+308 1.7E+308 ECU_ADDRESS 0x00211F10
 /begin IF_DATA XCP
  /begin DAQ_EVENT VARIABLE /begin DEFAULT_EVENT_LIST EVENT 0x0003 /end DEFAULT_EVENT_LIST /end DAQ_EVENT
 /end IF_DATA
/end MEASUREMENT
/begin MEASUREMENT H8_1GDL_B.TmpSignalConversionAtFilterDi_n "" FLOAT64_IEEE H8_1GDL_CM_double 0 0 -1.7E+308 1.7E+308 LAYOUT COLUMN_DIR MATRIX_DIM 2 ECU_ADDRESS 0x00211EC0
 /begin IF_DATA XCP
  /begin DAQ_EVENT VARIABLE /begin DEFAULT_EVENT_LIST EVENT 0x0002 /end DEFAULT_EVENT_LIST /end DAQ_EVENT
 /end IF_DATA
/end MEASUREMENT
/begin MEASUREMENT H8_1GDL_B.TmpSignalConversionAtFilterDiff "" FLOAT64_IEEE H8_1GDL_CM_double 0 0 -1.7E+308 1.7E+308 LAYOUT COLUMN_DIR MATRIX_DIM 2 ECU_ADDRESS 0x00211D98
 /begin IF_DATA XCP
  /begin DAQ_EVENT VARIABLE /begin DEFAULT_EVENT_LIST EVENT 0x0001 /end DEFAULT_EVENT_LIST /end DAQ_EVENT
 /end IF_DATA
/end MEASUREMENT
/begin MEASUREMENT H8_1GDL_B.Tsamp "" FLOAT64_IEEE H8_1GDL_CM_double 0 0 -1.7E+308 1.7E+308 ECU_ADDRESS 0x00211D70
 /begin IF_DATA XCP
  /begin DAQ_EVENT VARIABLE /begin DEFAULT_EVENT_LIST EVENT 0x0001 /end DEFAULT_EVENT_LIST /end DAQ_EVENT
 /end IF_DATA
/end MEASUREMENT
/begin MEASUREMENT H8_1GDL_B.Tsamp_e "" FLOAT64_IEEE H8_1GDL_CM_double 0 0 -1.7E+308 1.7E+308 ECU_ADDRESS 0x00211E98
 /begin IF_DATA XCP
  /begin DAQ_EVENT VARIABLE /begin DEFAULT_EVENT_LIST EVENT 0x0002 /end DEFAULT_EVENT_LIST /end DAQ_EVENT
 /end IF_DATA
/end MEASUREMENT
/begin MEASUREMENT H8_1GDL_B.ZeroOrderHold "" FLOAT64_IEEE H8_1GDL_CM_double 0 0 -1.7E+308 1.7E+308 ECU_ADDRESS 0x00211F18
 /begin IF_DATA XCP
  /begin DAQ_EVENT VARIABLE /begin DEFAULT_EVENT_LIST EVENT 0x0003 /end DEFAULT_EVENT_LIST /end DAQ_EVENT
 /end IF_DATA
/end MEASUREMENT
/begin MEASUREMENT H8_1GDL_B.airgap "" FLOAT64_IEEE H8_1GDL_CM_double 0 0 -1.7E+308 1.7E+308 ECU_ADDRESS 0x00211D10 /end MEASUREMENT
/begin MEASUREMENT H8_1GDL_B.airgap_sensorI "" FLOAT64_IEEE H8_1GDL_CM_double 0 0 -1.7E+308 1.7E+308 ECU_ADDRESS 0x00211D48
 /begin IF_DATA XCP
  /begin DAQ_EVENT VARIABLE /begin DEFAULT_EVENT_LIST EVENT 0x0001 /end DEFAULT_EVENT_LIST /end DAQ_EVENT
 /end IF_DATA
/end MEASUREMENT
/begin MEASUREMENT H8_1GDL_B.current "" FLOAT64_IEEE H8_1GDL_CM_double 0 0 -1.7E+308 1.7E+308 ECU_ADDRESS 0x00211E50
 /begin IF_DATA XCP
  /begin DAQ_EVENT VARIABLE /begin DEFAULT_EVENT_LIST EVENT 0x0001 /end DEFAULT_EVENT_LIST /end DAQ_EVENT
 /end IF_DATA
/end MEASUREMENT
/begin MEASUREMENT H8_1GDL_B.currentapplied "" FLOAT64_IEEE H8_1GDL_CM_double 0 0 -1.7E+308 1.7E+308 ECU_ADDRESS 0x00211D18 /end MEASUREMENT
/begin MEASUREMENT H8_1GDL_B.masa_bobina "" FLOAT64_IEEE H8_1GDL_CM_double 0 0 -1.7E+308 1.7E+308 ECU_ADDRESS 0x00211E08 /end MEASUREMENT
/begin MEASUREMENT H8_1GDL_B.senal_discretizada "" FLOAT64_IEEE H8_1GDL_CM_double 0 0 -1.7E+308 1.7E+308 ECU_ADDRESS 0x00211F58
 /begin IF_DATA XCP
  /begin DAQ_EVENT VARIABLE /begin DEFAULT_EVENT_LIST EVENT 0x0003 /end DEFAULT_EVENT_LIST /end DAQ_EVENT
 /end IF_DATA
/end MEASUREMENT
/begin MEASUREMENT H8_1GDL_B.suelotecho "" FLOAT64_IEEE H8_1GDL_CM_double 0 0 -1.7E+308 1.7E+308 ECU_ADDRESS 0x00211CF8 /end MEASUREMENT
/begin MEASUREMENT H8_1GDL_B.v "" FLOAT64_IEEE H8_1GDL_CM_double 0 0 -1.7E+308 1.7E+308 ECU_ADDRESS 0x00211D58 /end MEASUREMENT
/begin MEASUREMENT H8_1GDL_B.vs "" FLOAT64_IEEE H8_1GDL_CM_double 0 0 -1.7E+308 1.7E+308 ECU_ADDRESS 0x00211DE0
 /begin IF_DATA XCP
  /begin DAQ_EVENT VARIABLE /begin DEFAULT_EVENT_LIST EVENT 0x0001 /end DEFAULT_EVENT_LIST /end DAQ_EVENT
 /end IF_DATA
/end MEASUREMENT
/begin MEASUREMENT H8_1GDL_B.x "" FLOAT64_IEEE H8_1GDL_CM_double 0 0 -1.7E+308 1.7E+308 ECU_ADDRESS 0x00211CF0 /end MEASUREMENT
/begin MEASUREMENT H8_1GDL_B.zaxisposition "" FLOAT64_IEEE H8_1GDL_CM_double 0 0 -1.7E+308 1.7E+308 ECU_ADDRESS 0x00211D00 /end MEASUREMENT
/begin MEASUREMENT H8_1GDL_DW.Delay1_DSTATE "" FLOAT64_IEEE H8_1GDL_CM_double 0 0 -1.7E+308 1.7E+308 ECU_ADDRESS 0x00211BB8
 /begin IF_DATA XCP
  /begin DAQ_EVENT VARIABLE /begin DEFAULT_EVENT_LIST EVENT 0x0001 /end DEFAULT_EVENT_LIST /end DAQ_EVENT
 /end IF_DATA
/end MEASUREMENT
/begin MEASUREMENT H8_1GDL_DW.Delay1_DSTATE_j "" FLOAT64_IEEE H8_1GDL_CM_double 0 0 -1.7E+308 1.7E+308 ECU_ADDRESS 0x00211C10
 /begin IF_DATA XCP
  /begin DAQ_EVENT VARIABLE /begin DEFAULT_EVENT_LIST EVENT 0x0003 /end DEFAULT_EVENT_LIST /end DAQ_EVENT
 /end IF_DATA
/end MEASUREMENT
/begin MEASUREMENT H8_1GDL_DW.Delay2_DSTATE "" FLOAT64_IEEE H8_1GDL_CM_double 0 0 -1.7E+308 1.7E+308 ECU_ADDRESS 0x00211BC0
 /begin IF_DATA XCP
  /begin DAQ_EVENT VARIABLE /begin DEFAULT_EVENT_LIST EVENT 0x0001 /end DEFAULT_EVENT_LIST /end DAQ_EVENT
 /end IF_DATA
/end MEASUREMENT
/begin MEASUREMENT H8_1GDL_DW.Delay3_DSTATE "" FLOAT64_IEEE H8_1GDL_CM_double 0 0 -1.7E+308 1.7E+308 ECU_ADDRESS 0x00211BC8
 /begin IF_DATA XCP
  /begin DAQ_EVENT VARIABLE /begin DEFAULT_EVENT_LIST EVENT 0x0001 /end DEFAULT_EVENT_LIST /end DAQ_EVENT
 /end IF_DATA
/end MEASUREMENT
/begin MEASUREMENT H8_1GDL_DW.Delay_DSTATE "" FLOAT64_IEEE H8_1GDL_CM_double 0 0 -1.7E+308 1.7E+308 ECU_ADDRESS 0x00211BB0
 /begin IF_DATA XCP
  /begin DAQ_EVENT VARIABLE /begin DEFAULT_EVENT_LIST EVENT 0x0001 /end DEFAULT_EVENT_LIST /end DAQ_EVENT
 /end IF_DATA
/end MEASUREMENT
/begin MEASUREMENT H8_1GDL_DW.Delay_DSTATE_f "" FLOAT64_IEEE H8_1GDL_CM_double 0 0 -1.7E+308 1.7E+308 LAYOUT COLUMN_DIR MATRIX_DIM 6 ECU_ADDRESS 0x00211BE0
 /begin IF_DATA XCP
  /begin DAQ_EVENT VARIABLE /begin DEFAULT_EVENT_LIST EVENT 0x0003 /end DEFAULT_EVENT_LIST /end DAQ_EVENT
 /end IF_DATA
/end MEASUREMENT
/begin MEASUREMENT H8_1GDL_DW.FilterDifferentiatorTF_states "" FLOAT64_IEEE H8_1GDL_CM_double 0 0 -1.7E+308 1.7E+308 ECU_ADDRESS 0x00211BA0
 /begin IF_DATA XCP
  /begin DAQ_EVENT VARIABLE /begin DEFAULT_EVENT_LIST EVENT 0x0001 /end DEFAULT_EVENT_LIST /end DAQ_EVENT
 /end IF_DATA
/end MEASUREMENT
/begin MEASUREMENT H8_1GDL_DW.FilterDifferentiatorTF_states_h "" FLOAT64_IEEE H8_1GDL_CM_double 0 0 -1.7E+308 1.7E+308 ECU_ADDRESS 0x00211BD0
 /begin IF_DATA XCP
  /begin DAQ_EVENT VARIABLE /begin DEFAULT_EVENT_LIST EVENT 0x0002 /end DEFAULT_EVENT_LIST /end DAQ_EVENT
 /end IF_DATA
/end MEASUREMENT
/begin MEASUREMENT H8_1GDL_DW.FilterDifferentiatorTF_tmp "" FLOAT64_IEEE H8_1GDL_CM_double 0 0 -1.7E+308 1.7E+308 ECU_ADDRESS 0x00211C48
 /begin IF_DATA XCP
  /begin DAQ_EVENT VARIABLE /begin DEFAULT_EVENT_LIST EVENT 0x0001 /end DEFAULT_EVENT_LIST /end DAQ_EVENT
 /end IF_DATA
/end MEASUREMENT
/begin MEASUREMENT H8_1GDL_DW.FilterDifferentiatorTF_tmp_e "" FLOAT64_IEEE H8_1GDL_CM_double 0 0 -1.7E+308 1.7E+308 ECU_ADDRESS 0x00211C60
 /begin IF_DATA XCP
  /begin DAQ_EVENT VARIABLE /begin DEFAULT_EVENT_LIST EVENT 0x0002 /end DEFAULT_EVENT_LIST /end DAQ_EVENT
 /end IF_DATA
/end MEASUREMENT
/begin MEASUREMENT H8_1GDL_DW.Integrator_DSTATE "" FLOAT64_IEEE H8_1GDL_CM_double 0 0 -1.7E+308 1.7E+308 ECU_ADDRESS 0x00211BA8
 /begin IF_DATA XCP
  /begin DAQ_EVENT VARIABLE /begin DEFAULT_EVENT_LIST EVENT 0x0001 /end DEFAULT_EVENT_LIST /end DAQ_EVENT
 /end IF_DATA
/end MEASUREMENT
/begin MEASUREMENT H8_1GDL_DW.Integrator_DSTATE_i "" FLOAT64_IEEE H8_1GDL_CM_double 0 0 -1.7E+308 1.7E+308 ECU_ADDRESS 0x00211BD8
 /begin IF_DATA XCP
  /begin DAQ_EVENT VARIABLE /begin DEFAULT_EVENT_LIST EVENT 0x0002 /end DEFAULT_EVENT_LIST /end DAQ_EVENT
 /end IF_DATA
/end MEASUREMENT
/begin MEASUREMENT H8_1GDL_DW.TmpRTBAtAdd5Inport1_Buf "" FLOAT64_IEEE H8_1GDL_CM_double 0 0 -1.7E+308 1.7E+308 LAYOUT COLUMN_DIR MATRIX_DIM 2 ECU_ADDRESS 0x00211C18
 /begin IF_DATA XCP
  /begin DAQ_EVENT VARIABLE /begin DEFAULT_EVENT_LIST EVENT 0x0001 /end DEFAULT_EVENT_LIST /end DAQ_EVENT
 /end IF_DATA
/end MEASUREMENT
/begin MEASUREMENT H8_1GDL_DW.TmpRTBAtAdd5Inport1_RdBufIdx "" SBYTE H8_1GDL_CM_int8 0 0 -128 127 ECU_ADDRESS 0x00211CB8
 /begin IF_DATA XCP
  /begin DAQ_EVENT VARIABLE /begin DEFAULT_EVENT_LIST EVENT 0x0001 /end DEFAULT_EVENT_LIST /end DAQ_EVENT
 /end IF_DATA
/end MEASUREMENT
/begin MEASUREMENT H8_1GDL_DW.TmpRTBAtAdd5Inport1_WrBufIdx "" SBYTE H8_1GDL_CM_int8 0 0 -128 127 ECU_ADDRESS 0x00211CB9
 /begin IF_DATA XCP
  /begin DAQ_EVENT VARIABLE /begin DEFAULT_EVENT_LIST EVENT 0x0001 /end DEFAULT_EVENT_LIST /end DAQ_EVENT
 /end IF_DATA
/end MEASUREMENT
/begin MEASUREMENT H8_1GDL_DW.TmpRTBAtSum1Outport1_Buf "" FLOAT64_IEEE H8_1GDL_CM_double 0 0 -1.7E+308 1.7E+308 LAYOUT COLUMN_DIR MATRIX_DIM 2 ECU_ADDRESS 0x00211C50
 /begin IF_DATA XCP
  /begin DAQ_EVENT VARIABLE /begin DEFAULT_EVENT_LIST EVENT 0x0002 /end DEFAULT_EVENT_LIST /end DAQ_EVENT
 /end IF_DATA
/end MEASUREMENT
/begin MEASUREMENT H8_1GDL_DW.TmpRTBAtSum1Outport1_RdBufIdx "" SBYTE H8_1GDL_CM_int8 0 0 -128 127 ECU_ADDRESS 0x00211CBE
 /begin IF_DATA XCP
  /begin DAQ_EVENT VARIABLE /begin DEFAULT_EVENT_LIST EVENT 0x0002 /end DEFAULT_EVENT_LIST /end DAQ_EVENT
 /end IF_DATA
/end MEASUREMENT
/begin MEASUREMENT H8_1GDL_DW.TmpRTBAtSum1Outport1_WrBufIdx "" SBYTE H8_1GDL_CM_int8 0 0 -128 127 ECU_ADDRESS 0x00211CBF
 /begin IF_DATA XCP
  /begin DAQ_EVENT VARIABLE /begin DEFAULT_EVENT_LIST EVENT 0x0002 /end DEFAULT_EVENT_LIST /end DAQ_EVENT
 /end IF_DATA
/end MEASUREMENT
/begin MEASUREMENT H8_1GDL_DW.TmpRTBAtZeroOrderHoldInport1_Bu "" FLOAT64_IEEE H8_1GDL_CM_double 0 0 -1.7E+308 1.7E+308 LAYOUT COLUMN_DIR MATRIX_DIM 2 ECU_ADDRESS 0x00211C38
 /begin IF_DATA XCP
  /begin DAQ_EVENT VARIABLE /begin DEFAULT_EVENT_LIST EVENT 0x0001 /end DEFAULT_EVENT_LIST /end DAQ_EVENT
 /end IF_DATA
/end MEASUREMENT
/begin MEASUREMENT H8_1GDL_DW.TmpRTBAtZeroOrderHoldInport1_Rd "" SBYTE H8_1GDL_CM_int8 0 0 -128 127 ECU_ADDRESS 0x00211CBC
 /begin IF_DATA XCP
  /begin DAQ_EVENT VARIABLE /begin DEFAULT_EVENT_LIST EVENT 0x0001 /end DEFAULT_EVENT_LIST /end DAQ_EVENT
 /end IF_DATA
/end MEASUREMENT
/begin MEASUREMENT H8_1GDL_DW.TmpRTBAtZeroOrderHoldInport1_Wr "" SBYTE H8_1GDL_CM_int8 0 0 -128 127 ECU_ADDRESS 0x00211CBD
 /begin IF_DATA XCP
  /begin DAQ_EVENT VARIABLE /begin DEFAULT_EVENT_LIST EVENT 0x0001 /end DEFAULT_EVENT_LIST /end DAQ_EVENT
 /end IF_DATA
/end MEASUREMENT
/begin MEASUREMENT H8_1GDL_DW.senal_discretizada_Buf "" FLOAT64_IEEE H8_1GDL_CM_double 0 0 -1.7E+308 1.7E+308 LAYOUT COLUMN_DIR MATRIX_DIM 2 ECU_ADDRESS 0x00211C28
 /begin IF_DATA XCP
  /begin DAQ_EVENT VARIABLE /begin DEFAULT_EVENT_LIST EVENT 0x0001 /end DEFAULT_EVENT_LIST /end DAQ_EVENT
 /end IF_DATA
/end MEASUREMENT
/begin MEASUREMENT H8_1GDL_DW.senal_discretizada_RdBufIdx "" SBYTE H8_1GDL_CM_int8 0 0 -128 127 ECU_ADDRESS 0x00211CBA
 /begin IF_DATA XCP
  /begin DAQ_EVENT VARIABLE /begin DEFAULT_EVENT_LIST EVENT 0x0001 /end DEFAULT_EVENT_LIST /end DAQ_EVENT
 /end IF_DATA
/end MEASUREMENT
/begin MEASUREMENT H8_1GDL_DW.senal_discretizada_WrBufIdx "" SBYTE H8_1GDL_CM_int8 0 0 -128 127 ECU_ADDRESS 0x00211CBB
 /begin IF_DATA XCP
  /begin DAQ_EVENT VARIABLE /begin DEFAULT_EVENT_LIST EVENT 0x0001 /end DEFAULT_EVENT_LIST /end DAQ_EVENT
 /end IF_DATA
/end MEASUREMENT
/begin COMPU_METHOD H8_1GDL_CM_double "Q = V" IDENTICAL "%15.10" "" /end COMPU_METHOD
/begin COMPU_METHOD H8_1GDL_CM_int8 "Q = V" IDENTICAL "%3.0" "" /end COMPU_METHOD
/begin COMPU_METHOD H8_1GDL_CM_uint32 "Q = V" IDENTICAL "%10.0" "" /end COMPU_METHOD
/begin RECORD_LAYOUT Record_FLOAT64_IEEE FNC_VALUES 1 FLOAT64_IEEE COLUMN_DIR DIRECT /end RECORD_LAYOUT
/begin RECORD_LAYOUT Record_SBYTE FNC_VALUES 1 SBYTE COLUMN_DIR DIRECT /end RECORD_LAYOUT
/begin RECORD_LAYOUT Record_ULONG FNC_VALUES 1 ULONG COLUMN_DIR DIRECT /end RECORD_LAYOUT
/begin GROUP H8_1GDL "H8_1GDL" /* Root */ ROOT
 /begin SUB_GROUP H8_1GDL_Airgap_Sensor1 H8_1GDL_PID_Controller3 H8_1GDL_PID_Controller4 H8_1GDL_Subsystem /end SUB_GROUP
 /begin REF_CHARACTERISTIC H8_1GDL_P.Integrator4_IC H8_1GDL_P.Saturation1_LowerSat H8_1GDL_P.Saturation1_UpperSat H8_1GDL_P.Saturation6_LowerSat H8_1GDL_P.Saturation6_UpperSat H8_1GDL_P.Temperature_Value H8_1GDL_P.dist_sensor1_Value H8_1GDL_P.dist_sensor_Value H8_1GDL_P.g H8_1GDL_P.lev_nom H8_1GDL_P.m H8_1GDL_P.suelo H8_1GDL_P.techo /end REF_CHARACTERISTIC
 /begin REF_MEASUREMENT H8_1GDL_B.Add5 H8_1GDL_B.Divide2 H8_1GDL_B.F H8_1GDL_B.Fg H8_1GDL_B.Fl H8_1GDL_B.I H8_1GDL_B.Saturation6 H8_1GDL_B.Sum H8_1GDL_B.Sum1_e H8_1GDL_B.Sum3 H8_1GDL_B.Sum_e H8_1GDL_B.Sum_f H8_1GDL_B.TmpRTBAtAdd5Inport1 H8_1GDL_B.senal_discretizada H8_1GDL_B.suelotecho H8_1GDL_B.v H8_1GDL_B.vs H8_1GDL_B.x H8_1GDL_B.zaxisposition /end REF_MEASUREMENT
/end GROUP
/begin GROUP H8_1GDL_Airgap_Sensor1 "H8_1GDL/Airgap Sensor1"
 /begin SUB_GROUP H8_1GDL_Airgap_Sensor1_Discr_Ampl H8_1GDL_Airgap_Sensor1_Moving_Average_Filter /end SUB_GROUP
 /begin REF_MEASUREMENT H8_1GDL_B.Gain H8_1GDL_B.TmpRTBAtZeroOrderHoldInport1 H8_1GDL_B.ZeroOrderHold H8_1GDL_B.airgap_sensorI H8_1GDL_B.zaxisposition H8_1GDL_DW.Scope1_PWORK_f H8_1GDL_DW.Scope2_PWORK /end REF_MEASUREMENT
/end GROUP
/begin GROUP H8_1GDL_Airgap_Sensor1_Discr_Ampl "H8_1GDL/Airgap Sensor1/Discr_Ampl"
 /begin REF_CHARACTERISTIC H8_1GDL_P.Discr_Ampl_Max H8_1GDL_P.Discr_Ampl_Min H8_1GDL_P.Discr_Ampl_N /end REF_CHARACTERISTIC
 /begin REF_MEASUREMENT H8_1GDL_B.Gain H8_1GDL_B.senal_discretizada /end REF_MEASUREMENT
/end GROUP
/begin GROUP H8_1GDL_Airgap_Sensor1_Moving_Average_Filter "H8_1GDL/Airgap Sensor1/Moving Average Filter"
 /begin REF_CHARACTERISTIC H8_1GDL_P.Delay1_InitialCondition_l H8_1GDL_P.Delay_InitialCondition_j H8_1GDL_P.MovingAverageFilter_M /end REF_CHARACTERISTIC
 /begin REF_MEASUREMENT H8_1GDL_B.Delay1_n H8_1GDL_B.Delay_j H8_1GDL_B.Gain H8_1GDL_B.Sum1_a H8_1GDL_B.Sum_p H8_1GDL_B.ZeroOrderHold H8_1GDL_DW.Delay1_DSTATE_j H8_1GDL_DW.Delay_DSTATE_f /end REF_MEASUREMENT
/end GROUP
/begin GROUP H8_1GDL_P.hems ""
 /begin REF_CHARACTERISTIC H8_1GDL_P.hems.Airgap H8_1GDL_P.hems.Current H8_1GDL_P.hems.Force_Vertical H8_1GDL_P.hems.Flux H8_1GDL_P.hems.Force_Horizontal H8_1GDL_P.hems.Inductance H8_1GDL_P.hems.masa_bobina H8_1GDL_P.hems.Resistance /end REF_CHARACTERISTIC
/end GROUP
/begin GROUP H8_1GDL_PID_Controller3 "H8_1GDL/PID Controller3"
 /begin SUB_GROUP H8_1GDL_PID_Controller3_D_Gain H8_1GDL_PID_Controller3_Filter H8_1GDL_PID_Controller3_I_Gain H8_1GDL_PID_Controller3_Integrator H8_1GDL_PID_Controller3_N_Copy H8_1GDL_PID_Controller3_N_Gain H8_1GDL_PID_Controller3_Parallel_P_Gain H8_1GDL_PID_Controller3_Sum /end SUB_GROUP
/end GROUP
/begin GROUP H8_1GDL_PID_Controller3_D_Gain "H8_1GDL/PID Controller3/D Gain" /begin SUB_GROUP H8_1GDL_PID_Controller3_D_Gain_Internal_Parameters /end SUB_GROUP /end GROUP
/begin GROUP H8_1GDL_PID_Controller3_D_Gain_Internal_Parameters "H8_1GDL/PID Controller3/D Gain/Internal Parameters" /begin REF_CHARACTERISTIC H8_1GDL_P.PIDController3_D /end REF_CHARACTERISTIC /begin REF_MEASUREMENT H8_1GDL_B.DerivativeGain_a H8_1GDL_B.TmpRTBAtSum1Outport1 /end REF_MEASUREMENT /end GROUP
/begin GROUP H8_1GDL_PID_Controller3_Filter "H8_1GDL/PID Controller3/Filter" /begin SUB_GROUP H8_1GDL_PID_Controller3_Filter_Disc__Trapezoidal_Filter /end SUB_GROUP /end GROUP
/begin GROUP H8_1GDL_PID_Controller3_Filter_Disc__Trapezoidal_Filter "H8_1GDL/PID Controller3/Filter/Disc. Trapezoidal Filter"
 /begin SUB_GROUP H8_1GDL_PID_Controller3_Filter_Disc__Trapezoidal_Filter_Tsamp /end SUB_GROUP
 /begin REF_CHARACTERISTIC H8_1GDL_P.FilterDenConstant_Value H8_1GDL_P.FilterDifferentiatorTF_NumCoe_d H8_1GDL_P.PIDController3_InitialCondition /end REF_CHARACTERISTIC
 /begin REF_MEASUREMENT H8_1GDL_B.DenCoefOut_a H8_1GDL_B.DerivativeGain_a H8_1GDL_B.Divide_g H8_1GDL_B.FilterDifferentiatorTF_a H8_1GDL_B.Passthroughfortuning_f H8_1GDL_B.Reciprocal_n H8_1GDL_B.SumDen_k H8_1GDL_B.SumNum_h H8_1GDL_B.TmpSignalConversionAtFilterDi_n H8_1GDL_B.Tsamp_e H8_1GDL_DW.FilterDifferentiatorTF_states_h H8_1GDL_DW.FilterDifferentiatorTF_tmp_e /end REF_MEASUREMENT
/end GROUP
/begin GROUP H8_1GDL_PID_Controller3_Filter_Disc__Trapezoidal_Filter_Tsamp "H8_1GDL/PID Controller3/Filter/Disc. Trapezoidal Filter/Tsamp"
 /begin SUB_GROUP H8_1GDL_PID_Controller3_Filter_Disc__Trapezoidal_Filter_Tsamp_Internal_Ts /end SUB_GROUP
/end GROUP
/begin GROUP H8_1GDL_PID_Controller3_Filter_Disc__Trapezoidal_Filter_Tsamp_Internal_Ts "H8_1GDL/PID Controller3/Filter/Disc. Trapezoidal Filter/Tsamp/Internal Ts" /begin REF_CHARACTERISTIC H8_1GDL_P.Tsamp_WtEt_n /end REF_CHARACTERISTIC /begin REF_MEASUREMENT H8_1GDL_B.Passthroughfortuning_f H8_1GDL_B.Tsamp_e /end REF_MEASUREMENT /end GROUP
/begin GROUP H8_1GDL_PID_Controller3_I_Gain "H8_1GDL/PID Controller3/I Gain" /begin SUB_GROUP H8_1GDL_PID_Controller3_I_Gain_Internal_Parameters /end SUB_GROUP /end GROUP
/begin GROUP H8_1GDL_PID_Controller3_I_Gain_Internal_Parameters "H8_1GDL/PID Controller3/I Gain/Internal Parameters" /begin REF_CHARACTERISTIC H8_1GDL_P.PIDController3_I /end REF_CHARACTERISTIC /begin REF_MEASUREMENT H8_1GDL_B.IntegralGain_e H8_1GDL_B.TmpRTBAtSum1Outport1 /end REF_MEASUREMENT /end GROUP
/begin GROUP H8_1GDL_PID_Controller3_Integrator "H8_1GDL/PID Controller3/Integrator" /begin SUB_GROUP H8_1GDL_PID_Controller3_Integrator_Discrete /end SUB_GROUP /end GROUP
/begin GROUP H8_1GDL_PID_Controller3_Integrator_Discrete "H8_1GDL/PID Controller3/Integrator/Discrete" /begin REF_CHARACTERISTIC H8_1GDL_P.Integrator_gainval_d H8_1GDL_P.suelo /end REF_CHARACTERISTIC
 /begin REF_MEASUREMENT H8_1GDL_B.IntegralGain_e H8_1GDL_B.Integrator_n H8_1GDL_DW.Integrator_DSTATE_i /end REF_MEASUREMENT
/end GROUP
/begin GROUP H8_1GDL_PID_Controller3_N_Copy "H8_1GDL/PID Controller3/N Copy" /begin SUB_GROUP H8_1GDL_PID_Controller3_N_Copy_Internal_Parameters /end SUB_GROUP /end GROUP
/begin GROUP H8_1GDL_PID_Controller3_N_Copy_Internal_Parameters "H8_1GDL/PID Controller3/N Copy/Internal Parameters" /begin REF_CHARACTERISTIC H8_1GDL_P.PIDController3_N /end REF_CHARACTERISTIC /end GROUP
/begin GROUP H8_1GDL_PID_Controller3_N_Gain "H8_1GDL/PID Controller3/N Gain" /begin SUB_GROUP H8_1GDL_PID_Controller3_N_Gain_Internal_Parameters /end SUB_GROUP /end GROUP
/begin GROUP H8_1GDL_PID_Controller3_N_Gain_Internal_Parameters "H8_1GDL/PID Controller3/N Gain/Internal Parameters" /begin REF_CHARACTERISTIC H8_1GDL_P.PIDController3_N /end REF_CHARACTERISTIC /begin REF_MEASUREMENT H8_1GDL_B.DenCoefOut_a H8_1GDL_B.FilterCoefficient_a /end REF_MEASUREMENT /end GROUP
/begin GROUP H8_1GDL_PID_Controller3_Parallel_P_Gain "H8_1GDL/PID Controller3/Parallel P Gain"
 /begin SUB_GROUP H8_1GDL_PID_Controller3_Parallel_P_Gain_Internal_Parameters /end SUB_GROUP
/end GROUP
/begin GROUP H8_1GDL_PID_Controller3_Parallel_P_Gain_Internal_Parameters "H8_1GDL/PID Controller3/Parallel P Gain/Internal Parameters" /begin REF_CHARACTERISTIC H8_1GDL_P.PIDController3_P /end REF_CHARACTERISTIC
 /begin REF_MEASUREMENT H8_1GDL_B.ProportionalGain_g H8_1GDL_B.TmpRTBAtSum1Outport1 /end REF_MEASUREMENT
/end GROUP
/begin GROUP H8_1GDL_PID_Controller3_Sum "H8_1GDL/PID Controller3/Sum" /begin SUB_GROUP H8_1GDL_PID_Controller3_Sum_Sum_PID /end SUB_GROUP /end GROUP
/begin GROUP H8_1GDL_PID_Controller3_Sum_Sum_PID "H8_1GDL/PID Controller3/Sum/Sum_PID"
 /begin REF_MEASUREMENT H8_1GDL_B.FilterCoefficient_a H8_1GDL_B.Integrator_n H8_1GDL_B.ProportionalGain_g H8_1GDL_B.Sum_e /end REF_MEASUREMENT
/end GROUP
/begin GROUP H8_1GDL_PID_Controller4 "H8_1GDL/PID Controller4"
 /begin SUB_GROUP H8_1GDL_PID_Controller4_D_Gain H8_1GDL_PID_Controller4_Filter H8_1GDL_PID_Controller4_I_Gain H8_1GDL_PID_Controller4_Integrator H8_1GDL_PID_Controller4_N_Copy H8_1GDL_PID_Controller4_N_Gain H8_1GDL_PID_Controller4_Parallel_P_Gain H8_1GDL_PID_Controller4_Sum /end SUB_GROUP
/end GROUP
/begin GROUP H8_1GDL_PID_Controller4_D_Gain "H8_1GDL/PID Controller4/D Gain" /begin SUB_GROUP H8_1GDL_PID_Controller4_D_Gain_Internal_Parameters /end SUB_GROUP /end GROUP
/begin GROUP H8_1GDL_PID_Controller4_D_Gain_Internal_Parameters "H8_1GDL/PID Controller4/D Gain/Internal Parameters" /begin REF_CHARACTERISTIC H8_1GDL_P.PIDController4_D /end REF_CHARACTERISTIC /begin REF_MEASUREMENT H8_1GDL_B.Add5 H8_1GDL_B.DerivativeGain /end REF_MEASUREMENT /end GROUP
/begin GROUP H8_1GDL_PID_Controller4_Filter "H8_1GDL/PID Controller4/Filter" /begin SUB_GROUP H8_1GDL_PID_Controller4_Filter_Disc__Trapezoidal_Filter /end SUB_GROUP /end GROUP
/begin GROUP H8_1GDL_PID_Controller4_Filter_Disc__Trapezoidal_Filter "H8_1GDL/PID Controller4/Filter/Disc. Trapezoidal Filter"
 /begin SUB_GROUP H8_1GDL_PID_Controller4_Filter_Disc__Trapezoidal_Filter_Tsamp /end SUB_GROUP
 /begin REF_CHARACTERISTIC H8_1GDL_P.FilterDenConstant_Value_n H8_1GDL_P.FilterDifferentiatorTF_NumCoef H8_1GDL_P.PIDController4_InitialCondition /end REF_CHARACTERISTIC
 /begin REF_MEASUREMENT H8_1GDL_B.DenCoefOut H8_1GDL_B.DerivativeGain H8_1GDL_B.Divide H8_1GDL_B.FilterDifferentiatorTF H8_1GDL_B.Passthroughfortuning H8_1GDL_B.Reciprocal H8_1GDL_B.SumDen H8_1GDL_B.SumNum H8_1GDL_B.TmpSignalConversionAtFilterDiff H8_1GDL_B.Tsamp H8_1GDL_DW.FilterDifferentiatorTF_states H8_1GDL_DW.FilterDifferentiatorTF_tmp /end REF_MEASUREMENT
/end GROUP
/begin GROUP H8_1GDL_PID_Controller4_Filter_Disc__Trapezoidal_Filter_Tsamp "H8_1GDL/PID Controller4/Filter/Disc. Trapezoidal Filter/Tsamp"
 /begin SUB_GROUP H8_1GDL_PID_Controller4_Filter_Disc__Trapezoidal_Filter_Tsamp_Internal_Ts /end SUB_GROUP
/end GROUP
/begin GROUP H8_1GDL_PID_Controller4_Filter_Disc__Trapezoidal_Filter_Tsamp_Internal_Ts "H8_1GDL/PID Controller4/Filter/Disc. Trapezoidal Filter/Tsamp/Internal Ts" /begin REF_CHARACTERISTIC H8_1GDL_P.Tsamp_WtEt /end REF_CHARACTERISTIC /begin REF_MEASUREMENT H8_1GDL_B.Passthroughfortuning H8_1GDL_B.Tsamp /end REF_MEASUREMENT /end GROUP
/begin GROUP H8_1GDL_PID_Controller4_I_Gain "H8_1GDL/PID Controller4/I Gain" /begin SUB_GROUP H8_1GDL_PID_Controller4_I_Gain_Internal_Parameters /end SUB_GROUP /end GROUP
/begin GROUP H8_1GDL_PID_Controller4_I_Gain_Internal_Parameters "H8_1GDL/PID Controller4/I Gain/Internal Parameters" /begin REF_CHARACTERISTIC H8_1GDL_P.PIDController4_I /end REF_CHARACTERISTIC /begin REF_MEASUREMENT H8_1GDL_B.Add5 H8_1GDL_B.IntegralGain /end REF_MEASUREMENT /end GROUP
/begin GROUP H8_1GDL_PID_Controller4_Integrator "H8_1GDL/PID Controller4/Integrator" /begin SUB_GROUP H8_1GDL_PID_Controller4_Integrator_Discrete /end SUB_GROUP /end GROUP
/begin GROUP H8_1GDL_PID_Controller4_Integrator_Discrete "H8_1GDL/PID Controller4/Integrator/Discrete"
 /begin REF_CHARACTERISTIC H8_1GDL_P.Integrator_gainval H8_1GDL_P.PIDController4_InitialConditi_d /end REF_CHARACTERISTIC
 /begin REF_MEASUREMENT H8_1GDL_B.IntegralGain H8_1GDL_B.Integrator_c H8_1GDL_DW.Integrator_DSTATE /end REF_MEASUREMENT
/end GROUP
/begin GROUP H8_1GDL_PID_Controller4_N_Copy "H8_1GDL/PID Controller4/N Copy" /begin SUB_GROUP H8_1GDL_PID_Controller4_N_Copy_Internal_Parameters /end SUB_GROUP /end GROUP
/begin GROUP H8_1GDL_PID_Controller4_N_Copy_Internal_Parameters "H8_1GDL/PID Controller4/N Copy/Internal Parameters" /begin REF_CHARACTERISTIC H8_1GDL_P.PIDController4_N /end REF_CHARACTERISTIC /end GROUP
/begin GROUP H8_1GDL_PID_Controller4_N_Gain "H8_1GDL/PID Controller4/N Gain" /begin SUB_GROUP H8_1GDL_PID_Controller4_N_Gain_Internal_Parameters /end SUB_GROUP /end GROUP
/begin GROUP H8_1GDL_PID_Controller4_N_Gain_Internal_Parameters "H8_1GDL/PID Controller4/N Gain/Internal Parameters" /begin REF_CHARACTERISTIC H8_1GDL_P.PIDController4_N /end REF_CHARACTERISTIC /begin REF_MEASUREMENT H8_1GDL_B.DenCoefOut H8_1GDL_B.FilterCoefficient /end REF_MEASUREMENT /end GROUP
/begin GROUP H8_1GDL_PID_Controller4_Parallel_P_Gain "H8_1GDL/PID Controller4/Parallel P Gain"
 /begin SUB_GROUP H8_1GDL_PID_Controller4_Parallel_P_Gain_Internal_Parameters /end SUB_GROUP
/end GROUP
/begin GROUP H8_1GDL_PID_Controller4_Parallel_P_Gain_Internal_Parameters "H8_1GDL/PID Controller4/Parallel P Gain/Internal Parameters" /begin REF_CHARACTERISTIC H8_1GDL_P.PIDController4_P /end REF_CHARACTERISTIC /begin REF_MEASUREMENT H8_1GDL_B.Add5 H8_1GDL_B.ProportionalGain /end REF_MEASUREMENT /end GROUP
/begin GROUP H8_1GDL_PID_Controller4_Sum "H8_1GDL/PID Controller4/Sum" /begin SUB_GROUP H8_1GDL_PID_Controller4_Sum_Sum_PID /end SUB_GROUP /end GROUP
/begin GROUP H8_1GDL_PID_Controller4_Sum_Sum_PID "H8_1GDL/PID Controller4/Sum/Sum_PID"
 /begin REF_MEASUREMENT H8_1GDL_B.FilterCoefficient H8_1GDL_B.Integrator_c H8_1GDL_B.ProportionalGain H8_1GDL_B.Sum_f /end REF_MEASUREMENT
/end GROUP
/begin GROUP H8_1GDL_Subsystem "H8_1GDL/Subsystem"
 /begin SUB_GROUP H8_1GDL_Subsystem_Calentamiento_1___bobina H8_1GDL_Subsystem_RL /end SUB_GROUP
 /begin REF_CHARACTERISTIC H8_1GDL_P.Saturation8_LowerSat H8_1GDL_P.Saturation8_UpperSat H8_1GDL_P.Tomm_Gain H8_1GDL_P.hems H8_1GDL_P.uDLookupTable1_maxIndex H8_1GDL_P.uDLookupTable_maxIndex /end REF_CHARACTERISTIC
 /begin REF_MEASUREMENT H8_1GDL_B.Fl H8_1GDL_B.Fl_m H8_1GDL_B.I H8_1GDL_B.airgap H8_1GDL_B.currentapplied H8_1GDL_B.suelotecho H8_1GDL_DW.Scope_PWORK_n /end REF_MEASUREMENT
/end GROUP
/begin GROUP H8_1GDL_Subsystem_Calentamiento_1___bobina "H8_1GDL/Subsystem/Calentamiento 1 - bobina"
 /begin REF_CHARACTERISTIC H8_1GDL_P.Constant_Value H8_1GDL_P.Integrator_IC H8_1GDL_P.Seccion_Value H8_1GDL_P.Tamb_Value H8_1GDL_P.Tref_Value H8_1GDL_P.coeficiente_transferencia_Value H8_1GDL_P.densidad_Value H8_1GDL_P.hems H8_1GDL_P.resistividad_Value /end REF_CHARACTERISTIC
 /begin REF_MEASUREMENT H8_1GDL_B.Divide1 H8_1GDL_B.Divide_p H8_1GDL_B.I H8_1GDL_B.Integrator H8_1GDL_B.MathFunction H8_1GDL_B.Product H8_1GDL_B.Product1 H8_1GDL_B.Product2 H8_1GDL_B.Sum H8_1GDL_B.Sum1 H8_1GDL_B.Sum2 H8_1GDL_B.masa_bobina /end REF_MEASUREMENT
/end GROUP
/begin GROUP H8_1GDL_Subsystem_RL "H8_1GDL/Subsystem/RL" /begin SUB_GROUP H8_1GDL_Subsystem_RL_Subsystem /end SUB_GROUP
 /begin REF_CHARACTERISTIC H8_1GDL_P.Delay1_InitialCondition H8_1GDL_P.Delay2_InitialCondition H8_1GDL_P.Delay3_InitialCondition H8_1GDL_P.Delay_InitialCondition H8_1GDL_P.Integrator1_IC H8_1GDL_P.hems H8_1GDL_P.uDLookupTable_maxIndex_d /end REF_CHARACTERISTIC
 /begin REF_MEASUREMENT H8_1GDL_B.Add H8_1GDL_B.Delay H8_1GDL_B.Delay1 H8_1GDL_B.Delay2 H8_1GDL_B.Delay3 H8_1GDL_B.Divide2_h H8_1GDL_B.Divide_f H8_1GDL_B.L H8_1GDL_B.airgap H8_1GDL_B.current H8_1GDL_B.currentapplied H8_1GDL_B.vs H8_1GDL_DW.Delay1_DSTATE H8_1GDL_DW.Delay2_DSTATE H8_1GDL_DW.Delay3_DSTATE H8_1GDL_DW.Delay_DSTATE /end REF_MEASUREMENT
/end GROUP
/begin GROUP H8_1GDL_Subsystem_RL_Subsystem "H8_1GDL/Subsystem/RL/Subsystem" /begin REF_CHARACTERISTIC H8_1GDL_P.hems /end REF_CHARACTERISTIC /end GROUP
/end MODULE
/end PROJECT
/* (add any file trailer comments here) */
/* EOF H8_1GDL.a2l*/

/******************************************************************************
* ASAP2 file: RL.a2l
* Academic License - for use in teaching, academic research, and meeting
* course requirements at degree granting institutions only. Not for
* government, commercial, or other organizational use.
* Code generation for model "RL".
* Model version : 1.67
* Simulink Coder version : 10.6 R2022b
* C source code generated on : Tue Apr 04 14:16:48 2023
* Target selection: slrealtime.tlc
* Embedded hardware selection: Intel->x86-64 (Linux 64)
* Code generation objectives: Unspecified
* Validation result: Not run
* (add additional file header information here)
******************************************************************************/ ASAP2_VERSION 1 71
/* Version 1.71 */
/begin PROJECT ProjectName "Project Comment Goes Here"
/begin HEADER "Header Comments go here" /end HEADER
/begin MODULE ModuleName "Module Comment Goes Here"
/begin IF_DATA XCP
 /begin PROTOCOL_LAYER 0x0100 0x03E8 0x00C8 0x0000 0x0000 0x0000 0x0000 0x0000 0xFC 0x0578 BYTE_ORDER_MSB_LAST ADDRESS_GRANULARITY_BYTE OPTIONAL_CMD ALLOC_ODT_ENTRY OPTIONAL_CMD ALLOC_ODT OPTIONAL_CMD ALLOC_DAQ OPTIONAL_CMD FREE_DAQ OPTIONAL_CMD GET_DAQ_CLOCK OPTIONAL_CMD GET_DAQ_RESOLUTION_INFO OPTIONAL_CMD GET_DAQ_PROCESSOR_INFO OPTIONAL_CMD START_STOP_SYNCH OPTIONAL_CMD START_STOP_DAQ_LIST OPTIONAL_CMD SET_DAQ_LIST_MODE OPTIONAL_CMD WRITE_DAQ OPTIONAL_CMD SET_DAQ_PTR OPTIONAL_CMD GET_CAL_PAGE OPTIONAL_CMD SET_CAL_PAGE OPTIONAL_CMD COPY_CAL_PAGE OPTIONAL_CMD SHORT_DOWNLOAD OPTIONAL_CMD DOWNLOAD_MAX OPTIONAL_CMD DOWNLOAD OPTIONAL_CMD SHORT_UPLOAD OPTIONAL_CMD UPLOAD OPTIONAL_CMD SET_MTA OPTIONAL_CMD GET_SEGMENT_INFO OPTIONAL_CMD GET_PAGE_INFO OPTIONAL_CMD SET_SEGMENT_MODE OPTIONAL_CMD GET_SEGMENT_MODE OPTIONAL_CMD GET_PAG_PROCESSOR_INFO OPTIONAL_CMD MODIFY_BITS /end PROTOCOL_LAYER
 /begin DAQ DYNAMIC 0x0000 0x0080 0x00 OPTIMISATION_TYPE_DEFAULT ADDRESS_EXTENSION_FREE IDENTIFICATION_FIELD_TYPE_RELATIVE_WORD_ALIGNED GRANULARITY_ODT_ENTRY_SIZE_DAQ_BYTE 0xFF OVERLOAD_INDICATION_PID PRESCALER_SUPPORTED /begin STIM GRANULARITY_ODT_ENTRY_SIZE_STIM_BYTE 0xFF /end STIM /begin TIMESTAMP_SUPPORTED 0x0001 SIZE_DWORD UNIT_1US TIMESTAMP_FIXED /end TIMESTAMP_SUPPORTED /begin EVENT "250 us" "250 us" 0x0000 DAQ 0xFF 0x19 0x04 0x00 /end EVENT /end DAQ
 /begin XCP_ON_UDP_IP 0x0100 0x15B3 ADDRESS "192.168.7.5" /end XCP_ON_UDP_IP
/end IF_DATA
/begin MOD_PAR "MOD PAR Comment Goes Here" /end MOD_PAR
/begin MOD_COMMON "Mod Common Comment Here" BYTE_ORDER MSB_LAST ALIGNMENT_BYTE 1 ALIGNMENT_WORD 2 ALIGNMENT_LONG 4 ALIGNMENT_FLOAT32_IEEE 4 ALIGNMENT_FLOAT64_IEEE 8 ALIGNMENT_INT64 8 /end MOD_COMMON
/begin CHARACTERISTIC RL_P.Constant_Value "" VALUE 0x002105D8 Record_FLOAT64_IEEE 0 RL_CM_double -1.7E+308 1.7E+308 /end CHARACTERISTIC
/begin CHARACTERISTIC RL_P.Constant_Value_f "" VALUE 0x002106D8 Record_FLOAT64_IEEE 0 RL_CM_double -1.7E+308 1.7E+308 /end CHARACTERISTIC
/begin CHARACTERISTIC RL_P.Delay1_InitialCondition "" VALUE 0x00210710 Record_FLOAT64_IEEE 0 RL_CM_double -1.7E+308 1.7E+308 /end CHARACTERISTIC
/begin CHARACTERISTIC RL_P.Delay2_InitialCondition "" VALUE 0x00210718 Record_FLOAT64_IEEE 0 RL_CM_double -1.7E+308 1.7E+308 /end CHARACTERISTIC
/begin CHARACTERISTIC RL_P.Delay3_InitialCondition "" VALUE 0x00210720 Record_FLOAT64_IEEE 0 RL_CM_double -1.7E+308 1.7E+308 /end CHARACTERISTIC
/begin CHARACTERISTIC RL_P.Delay_InitialCondition "" VALUE 0x00210708 Record_FLOAT64_IEEE 0 RL_CM_double -1.7E+308 1.7E+308 /end CHARACTERISTIC
/begin CHARACTERISTIC RL_P.Integrator1_IC "" VALUE 0x002105C0 Record_FLOAT64_IEEE 0 RL_CM_double -1.7E+308 1.7E+308 /end CHARACTERISTIC
/begin CHARACTERISTIC RL_P.Integrator_IC "" VALUE 0x002105B0 Record_FLOAT64_IEEE 0 RL_CM_double -1.7E+308 1.7E+308 /end CHARACTERISTIC
/begin CHARACTERISTIC RL_P.PIDController4_D "" VALUE 0x00210580 Record_FLOAT64_IEEE 0 RL_CM_double -1.7E+308 1.7E+308 /end CHARACTERISTIC
/begin CHARACTERISTIC RL_P.PIDController4_I "" VALUE 0x00210588 Record_FLOAT64_IEEE 0 RL_CM_double -1.7E+308 1.7E+308 /end CHARACTERISTIC
/begin CHARACTERISTIC RL_P.PIDController4_InitialConditi_d "" VALUE 0x00210598 Record_FLOAT64_IEEE 0 RL_CM_double -1.7E+308 1.7E+308 /end CHARACTERISTIC
/begin CHARACTERISTIC RL_P.PIDController4_InitialCondition "" VALUE 0x00210590 Record_FLOAT64_IEEE 0 RL_CM_double -1.7E+308 1.7E+308 /end CHARACTERISTIC
/begin CHARACTERISTIC RL_P.PIDController4_N "" VALUE 0x002105A0 Record_FLOAT64_IEEE 0 RL_CM_double -1.7E+308 1.7E+308 /end CHARACTERISTIC
/begin CHARACTERISTIC RL_P.PIDController4_P "" VALUE 0x002105A8 Record_FLOAT64_IEEE 0 RL_CM_double -1.7E+308 1.7E+308 /end CHARACTERISTIC
/begin CHARACTERISTIC RL_P.Saturation1_LowerSat "" VALUE 0x002105E8 Record_FLOAT64_IEEE 0 RL_CM_double -1.7E+308 1.7E+308 /end CHARACTERISTIC
/begin CHARACTERISTIC RL_P.Saturation1_UpperSat "" VALUE 0x002105E0 Record_FLOAT64_IEEE 0 RL_CM_double -1.7E+308 1.7E+308 /end CHARACTERISTIC
/begin CHARACTERISTIC RL_P.Saturation8_LowerSat "" VALUE 0x002105D0 Record_FLOAT64_IEEE 0 RL_CM_double -1.7E+308 1.7E+308 /end CHARACTERISTIC
/begin CHARACTERISTIC RL_P.Saturation8_UpperSat "" VALUE 0x002105C8 Record_FLOAT64_IEEE 0 RL_CM_double -1.7E+308 1.7E+308 /end CHARACTERISTIC
/begin CHARACTERISTIC RL_P.Seccion_Value "" VALUE 0x002106E0 Record_FLOAT64_IEEE 0 RL_CM_double -1.7E+308 1.7E+308 /end CHARACTERISTIC
/begin CHARACTERISTIC RL_P.Tamb_Value "" VALUE 0x002105B8 Record_FLOAT64_IEEE 0 RL_CM_double -1.7E+308 1.7E+308 /end CHARACTERISTIC
/begin CHARACTERISTIC RL_P.Temperature_Value "" VALUE 0x00210728 Record_FLOAT64_IEEE 0 RL_CM_double -1.7E+308 1.7E+308 /end CHARACTERISTIC
/begin CHARACTERISTIC RL_P.Tomm_Gain "" VALUE 0x002105F0 Record_FLOAT64_IEEE 0 RL_CM_double -1.7E+308 1.7E+308 /end CHARACTERISTIC
/begin CHARACTERISTIC RL_P.Tref_Value "" VALUE 0x002106F0 Record_FLOAT64_IEEE 0 RL_CM_double -1.7E+308 1.7E+308 /end CHARACTERISTIC
/begin CHARACTERISTIC RL_P.coeficiente_transferencia_Value "" VALUE 0x00210700 Record_FLOAT64_IEEE 0 RL_CM_double -1.7E+308 1.7E+308 /end CHARACTERISTIC
/begin CHARACTERISTIC RL_P.densidad_Value "" VALUE 0x002106F8 Record_FLOAT64_IEEE 0 RL_CM_double -1.7E+308 1.7E+308 /end CHARACTERISTIC
/begin CHARACTERISTIC RL_P.hems.Airgap "" VAL_BLK 0x00204020 Record_FLOAT64_IEEE 0 RL_CM_double -1.7E+308 1.7E+308 MATRIX_DIM 14 1 /end CHARACTERISTIC
/begin CHARACTERISTIC RL_P.hems.Current "" VAL_BLK 0x00204090 Record_FLOAT64_IEEE 0 RL_CM_double -1.7E+308 1.7E+308 MATRIX_DIM 111 1 /end CHARACTERISTIC
/begin CHARACTERISTIC RL_P.hems.Flux "" VAL_BLK 0x00207498 Record_FLOAT64_IEEE 0 RL_CM_double -1.7E+308 1.7E+308 MATRIX_DIM 111 14 /end CHARACTERISTIC
/begin CHARACTERISTIC RL_P.hems.Force_Horizontal "" VAL_BLK 0x0020A528 Record_FLOAT64_IEEE 0 RL_CM_double -1.7E+308 1.7E+308 MATRIX_DIM 111 14 /end CHARACTERISTIC
/begin CHARACTERISTIC RL_P.hems.Force_Vertical "" VAL_BLK 0x00204408 Record_FLOAT64_IEEE 0 RL_CM_double -1.7E+308 1.7E+308 MATRIX_DIM 111 14 /end CHARACTERISTIC
/begin CHARACTERISTIC RL_P.hems.Inductance "" VAL_BLK 0x0020D5B8 Record_FLOAT64_IEEE 0 RL_CM_double -1.7E+308 1.7E+308 MATRIX_DIM 109 14 /end CHARACTERISTIC
/begin CHARACTERISTIC RL_P.hems.Resistance "" VALUE 0x00210570 Record_FLOAT64_IEEE 0 RL_CM_double -1.7E+308 1.7E+308 /end CHARACTERISTIC
/begin CHARACTERISTIC RL_P.hems.masa_bobina "" VALUE 0x00210568 Record_FLOAT64_IEEE 0 RL_CM_double -1.7E+308 1.7E+308 /end CHARACTERISTIC
/begin CHARACTERISTIC RL_P.lev_nom "" VALUE 0x00210578 Record_FLOAT64_IEEE 0 RL_CM_double -1.7E+308 1.7E+308 /end CHARACTERISTIC
/begin CHARACTERISTIC RL_P.resistividad_Value "" VALUE 0x002106E8 Record_FLOAT64_IEEE 0 RL_CM_double -1.7E+308 1.7E+308 /end CHARACTERISTIC
/begin CHARACTERISTIC RL_P.uDLookupTable1_maxIndex "" VAL_BLK 0x00210738 Record_ULONG 0 RL_CM_uint32 0 4294967295 MATRIX_DIM 2 /end CHARACTERISTIC
/begin CHARACTERISTIC RL_P.uDLookupTable_maxIndex "" VAL_BLK 0x00210730 Record_ULONG 0 RL_CM_uint32 0 4294967295 MATRIX_DIM 2 /end CHARACTERISTIC
/begin CHARACTERISTIC RL_P.uDLookupTable_maxIndex_d "" VAL_BLK 0x00210740 Record_ULONG 0 RL_CM_uint32 0 4294967295 MATRIX_DIM 2 /end CHARACTERISTIC
/begin MEASUREMENT RL_B.Add "" FLOAT64_IEEE RL_CM_double 0 0 -1.7E+308 1.7E+308 ECU_ADDRESS 0x00210BD0 /end MEASUREMENT
/begin MEASUREMENT RL_B.Add5 "" FLOAT64_IEEE RL_CM_double 0 0 -1.7E+308 1.7E+308 ECU_ADDRESS 0x00210B00 /end MEASUREMENT
/begin MEASUREMENT RL_B.Delay "" FLOAT64_IEEE RL_CM_double 0 0 -1.7E+308 1.7E+308 ECU_ADDRESS 0x00210BB0 /end MEASUREMENT
/begin MEASUREMENT RL_B.Delay1 "" FLOAT64_IEEE RL_CM_double 0 0 -1.7E+308 1.7E+308 ECU_ADDRESS 0x00210BB8 /end MEASUREMENT
/begin MEASUREMENT RL_B.Delay2 "" FLOAT64_IEEE RL_CM_double 0 0 -1.7E+308 1.7E+308 ECU_ADDRESS 0x00210BD8 /end MEASUREMENT
/begin MEASUREMENT RL_B.Delay3 "" FLOAT64_IEEE RL_CM_double 0 0 -1.7E+308 1.7E+308 ECU_ADDRESS 0x00210BE0 /end MEASUREMENT
/begin MEASUREMENT RL_B.DerivativeGain "" FLOAT64_IEEE RL_CM_double 0 0 -1.7E+308 1.7E+308 ECU_ADDRESS 0x00210B08 /end MEASUREMENT
/begin MEASUREMENT RL_B.Divide "" FLOAT64_IEEE RL_CM_double 0 0 -1.7E+308 1.7E+308 ECU_ADDRESS 0x00210B68 /end MEASUREMENT
/begin MEASUREMENT RL_B.Divide1 "" FLOAT64_IEEE RL_CM_double 0 0 -1.7E+308 1.7E+308 ECU_ADDRESS 0x00210BA8 /end MEASUREMENT
/begin MEASUREMENT RL_B.Divide2 "" FLOAT64_IEEE RL_CM_double 0 0 -1.7E+308 1.7E+308 ECU_ADDRESS 0x00210BE8 /end MEASUREMENT
/begin MEASUREMENT RL_B.Divide_f "" FLOAT64_IEEE RL_CM_double 0 0 -1.7E+308 1.7E+308 ECU_ADDRESS 0x00210BF0 /end MEASUREMENT
/begin MEASUREMENT RL_B.Filter "" FLOAT64_IEEE RL_CM_double 0 0 -1.7E+308 1.7E+308 ECU_ADDRESS 0x00210B10 /end MEASUREMENT
/begin MEASUREMENT RL_B.FilterCoefficient "" FLOAT64_IEEE RL_CM_double 0 0 -1.7E+308 1.7E+308 ECU_ADDRESS 0x00210B30 /end MEASUREMENT
/begin MEASUREMENT RL_B.Fl "" FLOAT64_IEEE RL_CM_double 0 0 -1.7E+308 1.7E+308 ECU_ADDRESS 0x00210B58 /end MEASUREMENT
/begin MEASUREMENT RL_B.Fl_m "" FLOAT64_IEEE RL_CM_double 0 0 -1.7E+308 1.7E+308 ECU_ADDRESS 0x00210B60 /end MEASUREMENT
/begin MEASUREMENT RL_B.I "" FLOAT64_IEEE RL_CM_double 0 0 -1.7E+308 1.7E+308 ECU_ADDRESS 0x00210AF8 /end MEASUREMENT
/begin MEASUREMENT RL_B.IntegralGain "" FLOAT64_IEEE RL_CM_double 0 0 -1.7E+308 1.7E+308 ECU_ADDRESS 0x00210B20 /end MEASUREMENT
/begin MEASUREMENT RL_B.Integrator "" FLOAT64_IEEE RL_CM_double 0 0 -1.7E+308 1.7E+308 ECU_ADDRESS 0x00210AE0 /end MEASUREMENT
/begin MEASUREMENT RL_B.Integrator_l "" FLOAT64_IEEE RL_CM_double 0 0 -1.7E+308 1.7E+308 ECU_ADDRESS 0x00210B28 /end MEASUREMENT
/begin MEASUREMENT RL_B.L "" FLOAT64_IEEE RL_CM_double 0 0 -1.7E+308 1.7E+308 ECU_ADDRESS 0x00210BC0 /end MEASUREMENT
/begin MEASUREMENT RL_B.MathFunction "" FLOAT64_IEEE RL_CM_double 0 0 -1.7E+308 1.7E+308 ECU_ADDRESS 0x00210B70 /end MEASUREMENT
/begin MEASUREMENT RL_B.Product "" FLOAT64_IEEE RL_CM_double 0 0 -1.7E+308 1.7E+308 ECU_ADDRESS 0x00210B98 /end MEASUREMENT
/begin MEASUREMENT RL_B.Product1 "" FLOAT64_IEEE RL_CM_double 0 0 -1.7E+308 1.7E+308 ECU_ADDRESS 0x00210B90 /end MEASUREMENT
/begin MEASUREMENT RL_B.Product2 "" FLOAT64_IEEE RL_CM_double 0 0 -1.7E+308 1.7E+308 ECU_ADDRESS 0x00210BA0 /end MEASUREMENT
/begin MEASUREMENT RL_B.ProportionalGain "" FLOAT64_IEEE RL_CM_double 0 0 -1.7E+308 1.7E+308 ECU_ADDRESS 0x00210B38 /end MEASUREMENT
/begin MEASUREMENT RL_B.Sum "" FLOAT64_IEEE RL_CM_double 0 0 -1.7E+308 1.7E+308 ECU_ADDRESS 0x00210AE8 /end MEASUREMENT
/begin MEASUREMENT RL_B.Sum1 "" FLOAT64_IEEE RL_CM_double 0 0 -1.7E+308 1.7E+308 ECU_ADDRESS 0x00210B78 /end MEASUREMENT
/begin MEASUREMENT RL_B.Sum2 "" FLOAT64_IEEE RL_CM_double 0 0 -1.7E+308 1.7E+308 ECU_ADDRESS 0x00210B88 /end MEASUREMENT
/begin MEASUREMENT RL_B.SumD "" FLOAT64_IEEE RL_CM_double 0 0 -1.7E+308 1.7E+308 ECU_ADDRESS 0x00210B18 /end MEASUREMENT
/begin MEASUREMENT RL_B.Sum_f "" FLOAT64_IEEE RL_CM_double 0 0 -1.7E+308 1.7E+308 ECU_ADDRESS 0x00210B40 /end MEASUREMENT
/begin MEASUREMENT RL_B.airgap "" FLOAT64_IEEE RL_CM_double 0 0 -1.7E+308 1.7E+308 ECU_ADDRESS 0x00210B50 /end MEASUREMENT
/begin MEASUREMENT RL_B.current "" FLOAT64_IEEE RL_CM_double 0 0 -1.7E+308 1.7E+308 ECU_ADDRESS 0x00210BC8 /end MEASUREMENT
/begin MEASUREMENT RL_B.currentapplied "" FLOAT64_IEEE RL_CM_double 0 0 -1.7E+308 1.7E+308 ECU_ADDRESS 0x00210AF0 /end MEASUREMENT
/begin MEASUREMENT RL_B.masa_bobina "" FLOAT64_IEEE RL_CM_double 0 0 -1.7E+308 1.7E+308 ECU_ADDRESS 0x00210B80 /end MEASUREMENT
/begin MEASUREMENT RL_B.vs "" FLOAT64_IEEE RL_CM_double 0 0 -1.7E+308 1.7E+308 ECU_ADDRESS 0x00210B48 /end MEASUREMENT
/begin MEASUREMENT RL_DW.Delay1_DSTATE "" FLOAT64_IEEE RL_CM_double 0 0 -1.7E+308 1.7E+308 ECU_ADDRESS 0x00210A88 /end MEASUREMENT
/begin MEASUREMENT RL_DW.Delay2_DSTATE "" FLOAT64_IEEE RL_CM_double 0 0 -1.7E+308 1.7E+308 ECU_ADDRESS 0x00210A90 /end MEASUREMENT
/begin MEASUREMENT RL_DW.Delay3_DSTATE "" FLOAT64_IEEE RL_CM_double 0 0 -1.7E+308 1.7E+308 ECU_ADDRESS 0x00210A98 /end MEASUREMENT
/begin MEASUREMENT RL_DW.Delay_DSTATE "" FLOAT64_IEEE RL_CM_double 0 0 -1.7E+308 1.7E+308 ECU_ADDRESS 0x00210A80 /end MEASUREMENT
/begin COMPU_METHOD /* Name of CompuMethod */ RL_CM_double "Q = V" /* Conversion Type */ IDENTICAL /* Format */ "%15.10" /* Units */ "" /end COMPU_METHOD
/begin COMPU_METHOD /* Name of CompuMethod */ RL_CM_uint32 "Q = V" /* Conversion Type */ IDENTICAL /* Format */ "%10.0" /* Units */ "" /end COMPU_METHOD
/begin RECORD_LAYOUT Record_FLOAT64_IEEE FNC_VALUES 1 FLOAT64_IEEE COLUMN_DIR DIRECT /end RECORD_LAYOUT
/begin RECORD_LAYOUT Record_ULONG FNC_VALUES 1 ULONG COLUMN_DIR DIRECT /end RECORD_LAYOUT
/begin GROUP RL "RL" /* Root */ ROOT /begin SUB_GROUP RL_PID_Controller4 RL_Subsystem /end SUB_GROUP
 /begin REF_CHARACTERISTIC RL_P.Constant_Value RL_P.Saturation1_LowerSat RL_P.Saturation1_UpperSat RL_P.Temperature_Value RL_P.lev_nom /end REF_CHARACTERISTIC
 /begin REF_MEASUREMENT RL_B.Add5 RL_B.I RL_B.Sum RL_B.Sum_f RL_B.vs /end REF_MEASUREMENT
/end GROUP
/begin GROUP RL_P.hems ""
 /begin REF_CHARACTERISTIC RL_P.hems.Airgap RL_P.hems.Current RL_P.hems.Force_Vertical RL_P.hems.Flux RL_P.hems.Force_Horizontal RL_P.hems.Inductance RL_P.hems.masa_bobina RL_P.hems.Resistance /end REF_CHARACTERISTIC
/end GROUP
/begin GROUP RL_PID_Controller4 "RL/PID Controller4"
 /begin SUB_GROUP RL_PID_Controller4_D_Gain RL_PID_Controller4_Filter RL_PID_Controller4_I_Gain RL_PID_Controller4_Integrator RL_PID_Controller4_N_Gain RL_PID_Controller4_Parallel_P_Gain RL_PID_Controller4_Sum /end SUB_GROUP
/end GROUP
/begin GROUP RL_PID_Controller4_D_Gain "RL/PID Controller4/D Gain" /begin SUB_GROUP RL_PID_Controller4_D_Gain_Internal_Parameters /end SUB_GROUP /end GROUP
/begin GROUP RL_PID_Controller4_D_Gain_Internal_Parameters "RL/PID Controller4/D Gain/Internal Parameters" /begin REF_CHARACTERISTIC RL_P.PIDController4_D /end REF_CHARACTERISTIC /begin REF_MEASUREMENT RL_B.Add5 RL_B.DerivativeGain /end REF_MEASUREMENT /end GROUP
/begin GROUP RL_PID_Controller4_Filter "RL/PID Controller4/Filter" /begin SUB_GROUP RL_PID_Controller4_Filter_Cont__Filter /end SUB_GROUP /end GROUP
/begin GROUP RL_PID_Controller4_Filter_Cont__Filter "RL/PID Controller4/Filter/Cont. Filter" /begin REF_CHARACTERISTIC RL_P.PIDController4_InitialCondition /end REF_CHARACTERISTIC
 /begin REF_MEASUREMENT RL_B.DerivativeGain RL_B.Filter RL_B.FilterCoefficient RL_B.SumD /end REF_MEASUREMENT
/end GROUP
/begin GROUP RL_PID_Controller4_I_Gain "RL/PID Controller4/I Gain" /begin SUB_GROUP RL_PID_Controller4_I_Gain_Internal_Parameters /end SUB_GROUP /end GROUP
/begin GROUP RL_PID_Controller4_I_Gain_Internal_Parameters "RL/PID Controller4/I Gain/Internal Parameters" /begin REF_CHARACTERISTIC RL_P.PIDController4_I /end REF_CHARACTERISTIC /begin REF_MEASUREMENT RL_B.Add5 RL_B.IntegralGain /end REF_MEASUREMENT /end GROUP
/begin GROUP RL_PID_Controller4_Integrator "RL/PID Controller4/Integrator" /begin SUB_GROUP RL_PID_Controller4_Integrator_Continuous /end SUB_GROUP /end GROUP
/begin GROUP RL_PID_Controller4_Integrator_Continuous "RL/PID Controller4/Integrator/Continuous" /begin REF_CHARACTERISTIC RL_P.PIDController4_InitialConditi_d /end REF_CHARACTERISTIC /begin REF_MEASUREMENT RL_B.IntegralGain RL_B.Integrator_l /end REF_MEASUREMENT /end GROUP
/begin GROUP RL_PID_Controller4_N_Gain "RL/PID Controller4/N Gain" /begin SUB_GROUP RL_PID_Controller4_N_Gain_Internal_Parameters /end SUB_GROUP /end GROUP
/begin GROUP RL_PID_Controller4_N_Gain_Internal_Parameters "RL/PID Controller4/N Gain/Internal Parameters" /begin REF_CHARACTERISTIC RL_P.PIDController4_N /end REF_CHARACTERISTIC /begin REF_MEASUREMENT RL_B.FilterCoefficient RL_B.SumD /end REF_MEASUREMENT /end GROUP
/begin GROUP RL_PID_Controller4_Parallel_P_Gain "RL/PID Controller4/Parallel P Gain" /begin SUB_GROUP RL_PID_Controller4_Parallel_P_Gain_Internal_Parameters /end SUB_GROUP /end GROUP
/begin GROUP RL_PID_Controller4_Parallel_P_Gain_Internal_Parameters "RL/PID Controller4/Parallel P Gain/Internal Parameters" /begin REF_CHARACTERISTIC RL_P.PIDController4_P /end REF_CHARACTERISTIC /begin REF_MEASUREMENT RL_B.Add5 RL_B.ProportionalGain /end REF_MEASUREMENT /end GROUP
/begin GROUP RL_PID_Controller4_Sum "RL/PID Controller4/Sum" /begin SUB_GROUP RL_PID_Controller4_Sum_Sum_PID /end SUB_GROUP /end GROUP
/begin GROUP RL_PID_Controller4_Sum_Sum_PID "RL/PID Controller4/Sum/Sum_PID"
 /begin REF_MEASUREMENT RL_B.FilterCoefficient RL_B.Integrator_l RL_B.ProportionalGain RL_B.Sum_f /end REF_MEASUREMENT
/end GROUP
/begin GROUP RL_Subsystem "RL/Subsystem" /begin SUB_GROUP RL_Subsystem_Calentamiento_1___bobina RL_Subsystem_RL /end SUB_GROUP
 /begin REF_CHARACTERISTIC RL_P.Saturation8_LowerSat RL_P.Saturation8_UpperSat RL_P.Tomm_Gain RL_P.hems RL_P.uDLookupTable1_maxIndex RL_P.uDLookupTable_maxIndex /end REF_CHARACTERISTIC
 /begin REF_MEASUREMENT RL_B.Fl RL_B.Fl_m RL_B.I RL_B.airgap RL_B.currentapplied RL_DW.Scope_PWORK /end REF_MEASUREMENT
/end GROUP
/begin GROUP RL_Subsystem_Calentamiento_1___bobina "RL/Subsystem/Calentamiento 1 - bobina"
 /begin REF_CHARACTERISTIC RL_P.Constant_Value_f RL_P.Integrator_IC RL_P.Seccion_Value RL_P.Tamb_Value RL_P.Tref_Value RL_P.coeficiente_transferencia_Value RL_P.densidad_Value RL_P.hems RL_P.resistividad_Value /end REF_CHARACTERISTIC
 /begin REF_MEASUREMENT RL_B.Divide RL_B.Divide1 RL_B.I RL_B.Integrator RL_B.MathFunction RL_B.Product RL_B.Product1 RL_B.Product2 RL_B.Sum RL_B.Sum1 RL_B.Sum2 RL_B.masa_bobina /end REF_MEASUREMENT
/end GROUP
/begin GROUP RL_Subsystem_RL "RL/Subsystem/RL" /begin SUB_GROUP RL_Subsystem_RL_Subsystem /end SUB_GROUP
 /begin REF_CHARACTERISTIC RL_P.Delay1_InitialCondition RL_P.Delay2_InitialCondition RL_P.Delay3_InitialCondition RL_P.Delay_InitialCondition RL_P.Integrator1_IC RL_P.hems RL_P.uDLookupTable_maxIndex_d /end REF_CHARACTERISTIC
 /begin REF_MEASUREMENT RL_B.Add RL_B.Delay RL_B.Delay1 RL_B.Delay2 RL_B.Delay3 RL_B.Divide2 RL_B.Divide_f RL_B.L RL_B.airgap RL_B.current RL_B.currentapplied RL_B.vs RL_DW.Delay1_DSTATE RL_DW.Delay2_DSTATE RL_DW.Delay3_DSTATE RL_DW.Delay_DSTATE /end REF_MEASUREMENT
/end GROUP
/begin GROUP RL_Subsystem_RL_Subsystem "RL/Subsystem/RL/Subsystem" /begin REF_CHARACTERISTIC RL_P.hems /end REF_CHARACTERISTIC /end GROUP
/end MODULE
/end PROJECT
/* (add any file trailer comments here) */
/* EOF RL.a2l*/
